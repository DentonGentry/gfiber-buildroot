## fs/simpleramfs/Config.in
```kconfig
config BR2_PACKAGE_SIMPLERAMFS
	bool "simpleramfs"
	select BR2_PACKAGE_TOYBOX
	select BR2_PACKAGE_TOOLBOX
	select BR2_PACKAGE_BUSYBOX
	select BR2_PACKAGE_DASH
	select BR2_PACKAGE_UTIL_LINUX
	select BR2_PACKAGE_MTD
	depends on !BR2_TARGET_ROOTFS_INITRAMFS
	help
	  Generate the simplest possible initramfs for finding,
	  verifying, and mounting the squashfs that contains the "real"
	  root filesystem.
```

## package/art2/Config.in
```kconfig
config BR2_PACKAGE_ART2
	bool "art2"
	depends on BR2_LINUX_KERNEL
	help
	  Enable this option if you want to build the Qualcomm Atheros Radio Test
	  kernel module

if BR2_PACKAGE_ART2

config BR2_PACKAGE_ART2_NART
	bool "Install nart utilities"
	default y
	help
	  Installs client tools for art driver.

endif
```

## package/backports-custom/Config.in
```kconfig
config BR2_PACKAGE_BACKPORTS_CUSTOM
	bool "Linux kernel driver backports-custom"
	depends on !BR2_PACKAGE_BACKPORTS
	help
	  The backports package includes many Linux drivers from recent
	  kernels, backported to older ones.

if BR2_PACKAGE_BACKPORTS_CUSTOM

config BR2_PACKAGE_BACKPORTS_CUSTOM_DEFCONFIG
	string "Backports-custom defconfig file"
	default "defconfig"
	help
	  Default config file for backports package for your platform.

config BR2_PACKAGE_BACKPORTS_CUSTOM_SITE
	string "Backports-custom site path"
	default "backports"
	help
	  Site path to backports-custom repository.

endif
```

## package/backports/Config.in
```kconfig
config BR2_PACKAGE_BACKPORTS
	bool "Linux kernel driver backports"
	help
	  The backports package includes many Linux drivers from recent
	  kernels, backported to older ones.

if BR2_PACKAGE_BACKPORTS

config BR2_PACKAGE_BACKPORTS_DEFCONFIG
	string "Backports defconfig file"
	default "defconfig"
	help
	  Default config file for backports package for your platform.

endif
```

## package/bcm_851xxapi/Config.in
```kconfig
config BR2_PACKAGE_BCM_851XXAPI
	bool bcm_851xxapi
	default n
	help
	  BCM_851XXAPI
```

## package/bcm_alsa/Config.in
```kconfig
config BR2_PACKAGE_BCM_ALSA
	bool "Build Broadcom ALSA package"
	select BR2_PACKAGE_BCM_NEXUS
	select BR2_PACKAGE_BCM_MAGNUM
	select BR2_PACKAGE_BCM_BSEAV
```

## package/bcm_apps/Config.in
```kconfig
config BR2_PACKAGE_BCM_APPS
	bool "bcm_apps"
	default true
	help
	  Build Broadcom AppLibs

menu "Broadcom supplied applications"

config BR2_PACKAGE_BCM_APP_REFSW
	bool "Nexus library"

config BR2_PACKAGE_BCM_APP_DLNA
	bool "DLNA components (DMS, DMP and DMC)"

config BR2_PACKAGE_BCM_APP_DIRECTFB
	bool "DirectFB"
	select BR2_PACKAGE_BCM_ROCKFORD

config BR2_PACKAGE_BCM_APP_BROWSER
	bool "WebKit browser"

config BR2_PACKAGE_BCM_APP_ICU
	bool "ICU library"

config BR2_PACKAGE_BCM_APP_NETFLIX
	bool "Netflix library"

endmenu
```

## package/bcm_bluetooth/Config.in
```kconfig
config BR2_PACKAGE_BCM_BLUETOOTH
	bool "Enable Broadcom Bluetooth"
	depends on !BR2_PACKAGE_GOOGLE_PLATFORM_ONLY
	default n
	help
	  Enable Broadcom Bluetooth

config BR2_PACKAGE_BCM_BLUETOOTH_BSA
	bool "Enable Broadcom Bluetooth BSA stack"
	depends on BR2_PACKAGE_BCM_BLUETOOTH
	select BR2_PACKAGE_BCM_COMMON
	select BR2_PACKAGE_ALSA_UTILS
	default n
	help
	  Enable Broadcom Bluetooth BSA stack

config BR2_PACKAGE_BCM_BLUETOOTH_FW
	bool "Install Broadcom Bluetooth firmware"
	depends on BR2_PACKAGE_BCM_BLUETOOTH
	default n
	help
	  Install Broadcom Bluetooth firmware
```

## package/bcm_bmoca/Config.in
```kconfig
config BR2_PACKAGE_BCM_BMOCA
	bool "Enable Broadcom MoCA v1/v2 kernel module"
	default n
	help
	  Includes Broadcom MoCA 1.0/2.0 kernel portion for 6802/6803/742x.
	  You must also enable BR2_PACKAGE_BCM_DRIVER_{MOCA,MOCA2} to get
	  a complete driver.
```

## package/bcm_bolt_signing/Config.in
```kconfig
config BR2_PACKAGE_BCM_BOLT_SIGNING
	bool "Enable Broadcom Bolt Signing"
	depends on BR2_PACKAGE_GOOGLE_PROD
	depends on BR2_TARGET_GENERIC_PLATFORM_NAME != "gfsc100"
	default y
	help
	  Broadcom signing tool for BOLT images.
```

## package/bcm_bseav/Config.in
```kconfig
config BR2_PACKAGE_BCM_BSEAV
	bool "bcm_bseav"
	select BR2_PACKAGE_BCM_COMMON
	help
	  Builds bcm_bseav for Broadcom boards
```

## package/bcm_cfe/Config.in
```kconfig
menu "Broadcom CFE"
	config BR2_PACKAGE_BCM_CFE
		bool "Enable Broadcom CFE (Google customized)"
		default n
		help
		  Builds for Broadcom CFE (Google customized)
endmenu
```

## package/bcm_chromium/Config.in
```kconfig
config BR2_PACKAGE_BCM_CHROMIUM
	bool "Build Broadcom Chromium package"
	select BR2_PACKAGE_BCM_COMMON
	select BR2_PACKAGE_BCM_ROCKFORD
```

## package/bcm_common/Config.in
```kconfig
config BR2_PACKAGE_BCM_COMMON
	bool "Build Broadcom common package"
	depends on !BR2_PACKAGE_GOOGLE_PLATFORM_ONLY

config BR2_PACKAGE_BCM_COMMON_PLATFORM
	string "Broadcom target platform"

config BR2_PACKAGE_BCM_COMMON_PLATFORM_REV
	string "Broadcom target platform revision"
```

## package/bcm_directfb/Config.in
```kconfig
config BR2_PACKAGE_BCM_DIRECTFB
	bool "broadcom's directfb"
	select BR2_PACKAGE_BCM_COMMON
	select BR2_PACKAGE_BCM_ROCKFORD
	help
	  http://www.directfb.org/
```

## package/bcm_drivers/Config.in
```kconfig
menu "Broadcom Drivers"
	config BR2_PACKAGE_BCM_DRIVERS
		bool "Enable Broadcom driver base"
		depends on !BR2_PACKAGE_GOOGLE_PLATFORM_ONLY
		default n
	config BR2_PACKAGE_BCM_DRIVER_MOCA
		bool "Enable Broadcom MoCA Driver v1"
		depends on BR2_PACKAGE_BCM_DRIVERS
		depends on !BR2_PACKAGE_BCM_DRIVER_MOCA2
		select BR2_PACKAGE_BCM_BMOCA
		default n
		help
		  Includes Broadcom MoCA 1.x userspace for 742x only.
	config BR2_PACKAGE_BCM_DRIVER_MOCA2
		bool "Enable Broadcom MoCA Driver v2"
		depends on BR2_PACKAGE_BCM_DRIVERS
		select BR2_PACKAGE_BCM_BMOCA
		default n
		help
		  Includes Broadcom MoCA 2.0 userspace for 6802/6803/742x.
	config BR2_PACKAGE_BCM_DRIVER_WIFI
		bool "Enable Broadcom WiFi Driver"
		depends on BR2_PACKAGE_BCM_DRIVERS
		default n
		help
		  Includes Broadcom Wifi driver.
	config BR2_PACKAGE_BCM_DRIVER_WIFI_USB
		bool "Enable Broadcom WiFi Driver for USB dongles"
		default n
		depends on BR2_PACKAGE_BCM_DRIVER_WIFI
endmenu
```

## package/bcm_magnum/Config.in
```kconfig
config BR2_PACKAGE_BCM_MAGNUM
	bool "Builds Magnum for Broadcom boards"
	select BR2_PACKAGE_BCM_COMMON
```

## package/bcm_miracast/Config.in
```kconfig
config BR2_PACKAGE_BCM_MIRACAST
	bool "Build Broadcom Miracast package"
	depends on !BR2_PACKAGE_GOOGLE_PLATFORM_ONLY
	default n
	select BR2_PACKAGE_BCM_COMMON
	select BR2_PACKAGE_BCM_ROCKFORD
```
