## package/golang/go_fsnotify/Config.in
```kconfig
config BR2_PACKAGE_GO_FSNOTIFY
        bool "go_fsnotify_dbus"
        help
          File system notifications for Go
```

## package/golang/go_glog/Config.in
```kconfig
config BR2_PACKAGE_GO_GLOG
        bool "go_glog"
        help
          Leveled execution logs for Go
```

## package/golang/go_goczmq/Config.in
```kconfig
config BR2_PACKAGE_GO_GOCZMQ
        bool "go_goczmq"
        select BR2_PACKAGE_CZMQ
        select BR2_PACKAGE_LIBSODIUM
        help
          CZMQ bindings for Go
```

## package/golang/go_godbus_dbus/Config.in
```kconfig
config BR2_PACKAGE_GO_GODBUS_DBUS
        bool "go_godbus_dbus"
        help
          Native Go bindings for D-Bus
```

## package/golang/go_golua/Config.in
```kconfig
config BR2_PACKAGE_GO_GOLUA
	bool "go_golua"
	help
		Go support for Lua bindings
```

## package/golang/go_gonzojive_mdns/Config.in
```kconfig
config BR2_PACKAGE_GO_GONZOJIVE_MDNS
        bool "go_gonzojive_mdns"
        help
          Simple mDNS client/server library in Golang
```

## package/golang/go_google_api/Config.in
```kconfig
config BR2_PACKAGE_GO_GOOGLE_API
        bool "go_google_api"
        help
          Auto-generated Google APIs for Go
```

## package/golang/go_grpc/Config.in
```kconfig
config BR2_PACKAGE_GO_GRPC
	bool "go_grpc"
	select BR2_PACKAGE_GO_NET
	help
		Go support for gRPC
```

## package/golang/go_guelfey_go_dbus/Config.in
```kconfig
config BR2_PACKAGE_GO_GUELFEY_GO_DBUS
        bool "go_guelfey_go_dbus"
        help
          Native Go bindings for D-Bus
```

## package/golang/go_luar/Config.in
```kconfig
config BR2_PACKAGE_GO_LUAR
	bool "go_luar"
	select BR2_PACKAGE_GO_GOLUA
	help
		Simpler Go support for Lua bindings
```

## package/golang/go_miekg_dns/Config.in
```kconfig
config BR2_PACKAGE_GO_MIEKG_DNS
        bool "go_miekg_dns"
        help
          DNS library in Go
```

## package/golang/go_mock/Config.in
```kconfig
config BR2_PACKAGE_GO_MOCK
        bool "go_mock"
        help
          GoMock - a mock framework for Go.
```

## package/golang/go_net/Config.in
```kconfig
config BR2_PACKAGE_GO_NET
        bool "go_net"
        help
          Go supplementary network libraries
```

## package/golang/go_oauth2/Config.in
```kconfig
config BR2_PACKAGE_GO_OAUTH2
        bool "go_oauth2"
        select BR2_PACKAGE_GO_CLOUD
        help
          Go support for oauth2
```

## package/golang/go_protobuf/Config.in
```kconfig
config BR2_PACKAGE_GO_PROTOBUF
        bool "go_protobuf"
        help
          Go support for Google's protocol buffers
```

## package/golang/go_shanemhansen_gossl/Config.in
```kconfig
config BR2_PACKAGE_GO_SHANEMHANSEN_GOSSL
	bool "go_shanemhansen_gossl"
	select BR2_PACKAGE_OPENSSL
	help
	  Go bindings to the openssl library
```

## package/golang/go_sys/Config.in
```kconfig
config BR2_PACKAGE_GO_SYS
        bool "go_sys"
        help
          Go packages for low-level interaction with the operating system
```

## package/golang/go_tpm/Config.in
```kconfig
config BR2_PACKAGE_GO_TPM
        bool "go_tpm"
        help
          Go-TPM is a Go library that communicates directly with a TPM on Linux.
```

## package/golang/go_vincenospam_go_dbus/Config.in
```kconfig
config BR2_PACKAGE_GO_VINCENOSPAM_GO_DBUS
        bool "go_vincenospam_go_dbus"
        help
          Native Go bindings for D-Bus
```

## package/google/Config.in
```kconfig
menu "Google libraries and applications"
source "package/google/google_dial/Config.in"
source "package/google/google_keystore_client/Config.in"
source "package/google/google_licenses/Config.in"
source "package/google/google_ffmpeg/Config.in"
source "package/google/google_miniclient/Config.in"
source "package/google/google_pullreader/Config.in"
source "package/google/google_dvbcapture/Config.in"
source "package/google/google_freetypejni/Config.in"
source "package/google/google_imageloadjni/Config.in"
source "package/google/google_jtux/Config.in"
source "package/google/google_mcastcapture/Config.in"
source "package/google/google_frobnicast/Config.in"
source "package/google/google_mobile_api/Config.in"
source "package/google/google_spicerack_migration/Config.in"
source "package/google/google_mpegparser/Config.in"
source "package/google/google_tvstreamparser/Config.in"
source "package/google/google_ts_check/Config.in"
source "package/google/google_sage_analytics_plugin/Config.in"
source "package/google/google_sagejni/Config.in"
source "package/google/google_sageserver/Config.in"
source "package/google/google_skelmir/Config.in"
source "package/google/google_swscale/Config.in"
source "package/google/google_gips/Config.in"
source "package/google/google_libjingle/Config.in"
source "package/google/google_vc/Config.in"
source "package/google/google_webrtc/Config.in"
source "package/google/google_widevine/Config.in"
source "package/google/google_signing/Config.in"
source "package/google/google_channel_srv/Config.in"
source "package/google/google_hdhomerun_plugin/Config.in"
source "package/google/google_hdcp/Config.in"
source "package/google/google_ookla/Config.in"
source "package/google/google_platform/Config.in"
source "package/google/google_prism/Config.in"
source "package/google/google_dart_vm/Config.in"
source "package/google/google_oregano/Config.in"
source "package/google/google_gflags/Config.in"
source "package/google/google_glog/Config.in"
source "package/google/google_gfrm200/Config.in"
source "package/google/google_spacecast/Config.in"
source "package/google/google_buffet/Config.in"
source "package/google/google_widevine_cenc/Config.in"
source "package/google/google_cryptohome/Config.in"
source "package/google/google_cast/Config.in"
source "package/google/google_glfw_nexus/Config.in"
source "package/google/google_glfw_dart/Config.in"
source "package/google/google_gl_dart/Config.in"
endmenu
```

## package/google/catawampus/Config.in
```kconfig
config BR2_PACKAGE_GOOGLE_CATAWAMPUS
	bool "catawampus"
	help
	  tr-69 management agent.
```

## package/google/dvbcapture/Config.in
```kconfig
config BR2_PACKAGE_GOOGLE_DVBCAPTURE
        bool "google_dvbcapture"
        help
          Builds the DVB Capture interface library
```

## package/google/freetypejni/Config.in
```kconfig
config BR2_PACKAGE_GOOGLE_FREETYPEJNI
        bool "google_freetypejni"
        help
          Builds the Freetype interface library
```

## package/google/ginstall/Config.in
```kconfig
config BR2_PACKAGE_GOOGLE_GINSTALL
	bool "google_ginstall"
	help
	  Installer for Google platforms.
```
