## package/bcm_netflix/Config.in
```kconfig
config BR2_PACKAGE_BCM_NETFLIX
	bool "Build Broadcom NetFlix package"
	select BR2_PACKAGE_BCM_COMMON
	select BR2_PACKAGE_BCM_DIRECTFB
	select BR2_PACKAGE_BCM_ROCKFORD
	select BR2_PACKAGE_CAIRO
	select BR2_PACKAGE_CAIRO_PDF
	select BR2_PACKAGE_CAIRO_PNG
	select BR2_PACKAGE_CAIRO_SVG
	select BR2_PACKAGE_DIRECTFB
	select BR2_PACKAGE_LIBCARES
	select BR2_PACKAGE_LIBMNG
	select BR2_PACKAGE_LIBXML2
	select BR2_PACKAGE_LIBXSLT
	select BR2_PACKAGE_NETFLIX_NRD
	select BR2_PACKAGE_SQLITE
	select BR2_PACKAGE_WEBP
```

## package/bcm_nexus/Config.in
```kconfig
config BR2_PACKAGE_BCM_NEXUS
	bool "bcm_nexus"
	select BR2_PACKAGE_BCM_COMMON
	select BR2_PACKAGE_BCM_MAGNUM
	help
	  Builds bcm_nexus for Broadcom boards
```

## package/bcm_oemcrypto/Config.in
```kconfig
config BR2_PACKAGE_BCM_OEMCRYPTO
	bool "bcm_oemcrypto"
	select BR2_PACKAGE_BCM_COMMON
	help
	  Builds bcm_oemcrypto for Broadcom boards
```

## package/bcm_rockford/Config.in
```kconfig
config BR2_PACKAGE_BCM_ROCKFORD
	bool "bcm_rockford"
	select BR2_PACKAGE_BCM_COMMON
	help
	  Builds bcm_rockford for Broadcom boards
```

## package/bcm_signing/Config.in
```kconfig
config BR2_PACKAGE_BCM_SIGNING
	bool "Enable Broadcom Signing"
	depends on BR2_PACKAGE_GOOGLE_PROD
	depends on BR2_TARGET_GENERIC_PLATFORM_NAME != "gfsc100"
	default y
	help
	  Broadcom signing tool.
```

## package/bcm_trellis/Config.in
```kconfig
config BR2_PACKAGE_BCM_TRELLIS
	bool "Build Broadcom Trellis (for chromium)"
	select BR2_PACKAGE_BCM_COMMON
	select BR2_PACKAGE_BCM_ROCKFORD
```

## package/bcm_webkit/Config.in
```kconfig
config BR2_PACKAGE_BCM_WEBKIT
	bool "Build Broadcom Webkit package (includes ICU, DLNA)"
	select BR2_PACKAGE_BCM_COMMON
	select BR2_PACKAGE_BCM_ROCKFORD
	select BR2_PACKAGE_LIBXML2
	select BR2_PACKAGE_LIBXSLT
	select BR2_PACKAGE_SQLITE
```

## package/bossa/Config.in
```kconfig
config BR2_PACKAGE_BOSSA
	bool "bossa"
	depends on BR2_INSTALL_LIBSTDCPP
	help
	  Flash tool for Atmel SAM

	  https://github.com/shumatech/BOSSA

comment "bossa requires a toolchain with C++ support enabled"
	depends on !BR2_INSTALL_LIBSTDCPP
```

## package/bruno/Config.in
```kconfig
config BR2_PACKAGE_BRUNO
	bool "Enable Bruno Board"
	default y
	help
	  Customization for Bruno boards.

config BR2_PACKAGE_BRUNO_OPENBOX
	bool "Openbox Release"
	default n
	help
	  Build bruno openbox release.

config BR2_PACKAGE_BRUNO_PROD
	bool "Production Release"
	default n
	depends on !BR2_PACKAGE_BRUNO_OPENBOX
	select BR2_PACKAGE_BCM_SIGNING
	help
	  Build bruno production release.

config BR2_PACKAGE_BRUNO_TEST
	bool "Include Test Packages"
	default n
	select BR2_PACKAGE_BONNIE
	select BR2_PACKAGE_DHRYSTONE
	select BR2_PACKAGE_DROPBEAR
	select BR2_PACKAGE_DROPBEAR_SMALL
	select BR2_PACKAGE_ETHTOOL
	select BR2_PACKAGE_FIO
	select BR2_PACKAGE_IPERF
	select BR2_PACKAGE_LMBENCH
	select BR2_PACKAGE_MEMSTAT
	select BR2_PACKAGE_MEMTESTER
	select BR2_PACKAGE_NETPERF
	select BR2_PACKAGE_STRACE
	select BR2_PACKAGE_TCPDUMP
	select BR2_PACKAGE_TCPDUMP_SMB
	select BR2_PACKAGE_UTIL_LINUX_LOGIN_UTILS
	select BR2_PACKAGE_UTIL_LINUX_AGETTY
	select BR2_PACKAGE_WHETSTONE
	select BR2_PACKAGE_SDPARM
	select BR2_PACKAGE_SYSSTAT
	help
	  Enable packages for test.

config BR2_PACKAGE_BRUNO_DEBUG
	bool "Bruno Debug Build"
	default n
	select BR2_ENABLE_DEBUG
	help
	  Enable debug code.

config BR2_PACKAGE_BRUNO_APPS
	bool "Bruno Applications (ie. SageTV)"
	default n
	select BR2_PACKAGE_GOOGLE_DVBCAPTURE
	select BR2_PACKAGE_GOOGLE_FFMPEG
	select BR2_PACKAGE_GOOGLE_FREETYPEJNI
	select BR2_PACKAGE_GOOGLE_IMAGELOADJNI
	select BR2_PACKAGE_GOOGLE_JTUX
	select BR2_PACKAGE_GOOGLE_MCASTCAPTURE
	select BR2_PACKAGE_GOOGLE_MPEGPARSER
	select BR2_PACKAGE_GOOGLE_PULLREADER
	select BR2_PACKAGE_GOOGLE_TVSTREAMPARSER
	select BR2_PACKAGE_GOOGLE_SAGEJNI
	select BR2_PACKAGE_GOOGLE_SAGESERVER
	select BR2_PACKAGE_GOOGLE_MINICLIENT
	select BR2_PACKAGE_GOOGLE_LICENSES
	select BR2_PACKAGE_GOOGLE_SIGNING
	select BR2_PACKAGE_GOOGLE_CHANNEL_SRV
	select BR2_PACKAGE_GOOGLE_HDHOMERUN_PLUGIN
	select BR2_PACKAGE_BCM_DRIVERS
	select BR2_PACKAGE_BCM_DRIVER_MOCA
	select BR2_PACKAGE_BCM_DRIVER_WIFI
	select BR2_PACKAGE_BCM_BLUETOOTH
	select BR2_PACKAGE_BCM_BSEAV
	select BR2_PACKAGE_BCM_NEXUS
	select BR2_PACKAGE_BCM_WEBKIT
	select BR2_PACKAGE_BCM_NETFLIX
	select BR2_PACKAGE_DIRECTFB
	select BR2_PACKAGE_BCM_DIRECTFB
	select BR2_PACKAGE_CAIRO
	select BR2_PACKAGE_CAIRO_PDF
	select BR2_PACKAGE_CAIRO_PNG
	select BR2_PACKAGE_CAIRO_SVG
	select BR2_PACKAGE_LIBPROJECTM

	help
	  Enable application level code.
```

## package/catawampus/Config.in
```kconfig
config BR2_PACKAGE_CATAWAMPUS
	bool "catawampus"
	select BR2_PACKAGE_PY_CURL
	select BR2_PACKAGE_PYTHON_NETIFACES
	select BR2_PACKAGE_PYTHON_ZLIB
	help
	  tr-69 management agent.
```

## package/chromium/Config.in
```kconfig
config BR2_PACKAGE_CHROMIUM
	bool "Build Chromium package"
	select BR2_PACKAGE_BCM_COMMON
	select BR2_PACKAGE_BCM_ROCKFORD
	select BR2_PACKAGE_BCM_TRELLIS
	select BR2_PACKAGE_LIBCAP
	select BR2_PACKAGE_LIBNSS
	select BR2_PACKAGE_NINJA
```

## package/clockspeed/Config.in
```kconfig
config BR2_PACKAGE_CLOCKSPEED
	bool "djb clockspeed"
	help
	  djb clockspeed is a collection of tools for fine-tuning your
	  system's clock.

	  http://cr.yp.to/clockspeed.html
```

## package/conntrack_tools/Config.in
```kconfig
config BR2_PACKAGE_CONNTRACK_TOOLS
	bool "conntrack_tools"
	depends on BR2_LARGEFILE
	select BR2_PACKAGE_LIBNETFILTER_CONNTRACK
	help
	  The conntrack-tools are the userspace daemon conntrackd and the
	  command line interface conntrack.

	  http://conntrack-tools.netfilter.org/

comment "conntrack_tools requires a toolchain with LARGEFILE support"
	depends on !BR2_LARGEFILE
```

## package/crashme/Config.in
```kconfig
config BR2_PACKAGE_CRASHME
	bool "crashme"
	help
	  A simple program for testing operating system robustness.
	  It invokes random data as if it were a procedure, then catches
	  fatal signals and tries to continue.

	  http://people.delphiforums.com/gjc/crashme.html
```

## package/dek_tools/Config.in
```kconfig
config BR2_PACKAGE_DEK_TOOLS
	bool "dek_tools"
	help
	  Adds Marvell's Device Embedding Kit applications
```

## package/execline/Config.in
```kconfig
config BR2_PACKAGE_EXECLINE
	bool "execline"
	select BR2_PACKAGE_SKALIBS
	help
	  A non-interactive scripting language with trivial syntax.

	  http://skarnet.org/software/execline/
```

## package/fio/Config.in
```kconfig
config BR2_PACKAGE_FIO
	bool "fio"
	depends on BR2_LINUX_KERNEL
	select BR2_PACKAGE_LIBAIO
	help
	  A userspace utility for hdd banchmark

	  git://git.kernel.dk/fio.git
```

## package/firmware/Config.in
```kconfig
config BR2_PACKAGE_FIRMWARE
	bool "Include vendor firmware blobs"

if BR2_PACKAGE_FIRMWARE

config BR2_PACKAGE_FIRMWARE_FILENAMES
	string "Firmware filenames"
	default ""
	help
	  Space-separated list of filenames relative to /lib/firmware/

endif
```

## package/freegrep/Config.in
```kconfig
config BR2_PACKAGE_FREEGREP
	bool "freegrep"
	help
	  The OpenBSD-derived free implementation of grep.

	  https://github.com/howardjp/freegrep
```

## package/ginstall/Config.in
```kconfig
config BR2_PACKAGE_GINSTALL
	bool "ginstall"
	help
	  Installer for Google platforms.
```

## package/golang/Config.in
```kconfig
menu "Go packages"
source "package/golang/go_fsnotify/Config.in"
source "package/golang/go_glog/Config.in"
source "package/golang/go_godbus_dbus/Config.in"
source "package/golang/go_gonzojive_mdns/Config.in"
source "package/golang/go_google_api/Config.in"
source "package/golang/go_grpc/Config.in"
source "package/golang/go_http2/Config.in"
source "package/golang/go_miekg_dns/Config.in"
source "package/golang/go_mock/Config.in"
source "package/golang/go_net/Config.in"
source "package/golang/go_oauth2/Config.in"
source "package/golang/go_protobuf/Config.in"
endmenu
```

## package/golang/go_cron/Config.in
```kconfig
config BR2_PACKAGE_GO_CRON
        bool "go_cron"
        help
          Cron spec parser and job runner for Go
```
