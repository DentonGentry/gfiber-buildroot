## package/igmpproxy/Config.in
```kconfig
config BR2_PACKAGE_IGMPPROXY
	bool "igmpproxy"
	help
	igmpproxy forwards multicast from wan to lan
```

## package/iperf3/Config.in
```kconfig
config BR2_PACKAGE_IPERF3
	bool "iperf3"
	depends on BR2_INSTALL_LIBSTDCPP
	help
	  Iperf was orginally developed by NLANR/DAST as a tool for measuring
	  maximum TCP and UDP bandwidth performance. Iperf allows the tuning
	  of various parameters and UDP characteristics. Iperf reports
	  bandwidth, delay jitter, datagram loss.

	  iperf3 is a new implementation from scratch, with the goal of a
	  smaller, simpler code base, and a library version of the
	  functionality that can be used in other programs. iperf3 has also a
	  number of features found in other tools such as nuttcp and netperf,
	  but were missing from iperf2.x.

	  Some new features in iperf3 include:

	   * reports the number of TCP packets that were retransmitted
	   * reports the average CPU utilization of the client and server (-V flag)
	   * support for zero copy TCP (-Z flag)
	   * JSON output format (-J flag)

	  Note that iperf3.x is not backwards compatible with iperf2.x

	  https://github.com/esnet/iperf

comment "iperf3 requires a toolchain with C++ support enabled"
	depends on !BR2_INSTALL_LIBSTDCPP
```

## package/iputils/Config.in
```kconfig
config BR2_PACKAGE_IPUTILS
	bool "iputils"
	depends on BR2_LINUX_KERNEL
	help
	  ping, ping6, traceroute, traceroute6

	  http://www.skbuff.net/iputils/
	  git://git.linux-ipv6.org/gitroot/iputils.git
```

## package/libcap/Config.in
```kconfig
config BR2_PACKAGE_LIBCAP
	bool "libcap"
	help
	 This library implements the user-space interfaces to the
	 POSIX 1003.1e capabilities available in Linux kernels. These
	 capabilities are a partitioning of the all powerful root
	 privilege into a set of distinct privileges.

	 http://sites.google.com/site/fullycapable/

config BR2_PACKAGE_LIBCAP_SETCAP
	bool "setcap"
	select BR2_PACKAGE_LIBCAP
	select BR2_PACKAGE_ATTR
	default n
	help
	  setcap - set file capabilities
```

## package/libcares/Config.in
```kconfig
config BR2_PACKAGE_LIBCARES
	bool "libcares"
	help
	  c-ares is a C library for asynchronous DNS requests.

	  http://c-ares.haxx.nu/
```

## package/libcurl_32/Config.in
```kconfig
config BR2_PACKAGE_LIBCURL_32
	bool "libcurl_32"
	help
	  cURL is a tool for getting files from FTP, HTTP, Gopher, Telnet,
	  and Dict servers, using any of the supported protocols.

	  http://curl.haxx.nu/
	  This package version is only meant for usage with Netflix
```

## package/libjsoncpp/Config.in
```kconfig
config BR2_PACKAGE_LIBJSONCPP
	bool "libjsoncpp"
	help
	  jsoncpp is an implementation of a JSON (http://json.org) reader and writer in C++

	  http://sourceforge.net/projects/jsoncpp/
```

## package/libtrace/Config.in
```kconfig
config BR2_PACKAGE_LIBTRACE
	bool "libtrace"
	help
	  A library and tools for processing network packet traces.

	  http://wand.net.nz/trac/libtrace
```

## package/libweave/Config.in
```kconfig
config BR2_PACKAGE_LIBWEAVE
	bool "libweave"
	select BR2_PACKAGE_EXPAT
	select BR2_PACKAGE_GOOGLETEST
	help
	  LibWeave is the library for device side implementation of the Weave
	  protocol.

	  https://weave.googlesource.com/weave/libweave
```

## package/logupload/Config.in
```kconfig
config BR2_PACKAGE_LOGUPLOAD
	bool "logupload"
	help
	  Tools for periodically uploading log files to a server.
```

## package/mindspeed_drivers/Config.in
```kconfig
menu "Mindspeed Drivers"
	config BR2_PACKAGE_MINDSPEED_DRIVERS
		bool "Enable Mindspeed driver base"
		default n
	config BR2_PACKAGE_MINDSPEED_DRIVER_PFE
		bool "Enable Mindspeed PFE Driver"
		depends on BR2_PACKAGE_MINDSPEED_DRIVERS
		default n
	config BR2_PACKAGE_MINDSPEED_DRIVERS_GIT_REPO_URL
		string "URL of Git repository"
		depends on BR2_PACKAGE_MINDSPEED_DRIVERS
		default "repo://vendor/mindspeed/drivers"
endmenu
```

## package/minijail/Config.in
```kconfig
config BR2_PACKAGE_MINIJAIL
	bool "google_minijail"
        select BR2_PACKAGE_LIBCAP
```

## package/minissdpd/Config.in
```kconfig
config BR2_PACKAGE_MINISSDPD
	bool "minissdpd"
	help
	minissdpd is an SSDP proxy to allow multiple UPnP programs to share port 1900.

	miniupnpd requires it in the runtime.

	http://miniupnp.free.fr/
```

## package/miniupnpd/Config.in
```kconfig
config BR2_PACKAGE_MINIUPNPD
	bool "miniupnpd"
	select BR2_PACKAGE_MINISSDPD
	help
	miniupnpd is an IGD and NAT-PMP daemon

	miniupnpd requires minissdpd in the runtime, but not to compile

	http://miniupnp.free.fr/
```

## package/mmc-utils/Config.in
```kconfig
config BR2_PACKAGE_MMC_UTILS
	bool "mmc-utils"
	depends on BR2_TOOLCHAIN_HEADERS_AT_LEAST_3_0
	help
	  MMC utils

	  https://git.kernel.org/cgit/linux/kernel/git/cjb/mmc-utils.git
```

## package/mrvl_mfg/Config.in
```kconfig
menu "Marvell manufacturing support"
	config BR2_PACKAGE_MRVL_MFG
		bool "Enable Marvell manufacturing software"
		depends on BR2_PACKAGE_BLUEZ_UTILS
		depends on !BR2_PACKAGE_GOOGLE_PLATFORM_ONLY
		default n
endmenu
```

## package/mtr/Config.in
```kconfig
config BR2_PACKAGE_MTR
	bool "mtr"
	depends on BR2_LINUX_KERNEL
	help
	  fullscreen ping/traceroute (IP6 as well)

	  http://www.bitwizard.nl/mtr/
```

## package/multimedia/libprojectM/Config.in
```kconfig
config BR2_PACKAGE_LIBPROJECTM
	bool "libprojectM"
	select BR2_PACKAGE_BCM_ROCKFORD
	help
	  Builds the ProjectM music visualization shared library.
```

## package/mv_app/Config.in
```kconfig
config BR2_PACKAGE_MV_APP_PON_TYPE
	string "XPON"
	depends on !BR2_PACKAGE_GOOGLE_OPENBOX
	help
	  PON Type, e.g. GPON, EPON.

config BR2_PACKAGE_MV_APP
	bool "mv_app"
	depends on !BR2_PACKAGE_GOOGLE_OPENBOX
	help
	  Builds application for Marvell boards
```

## package/mv_cpss/Config.in
```kconfig
config BR2_PACKAGE_MV_CPSS
	bool "mv_cpss"
	depends on !BR2_PACKAGE_GOOGLE_OPENBOX
	help
	  Builds cpss switch config tool for Marvell boards
```

## package/mv_cust/Config.in
```kconfig
config BR2_PACKAGE_MV_CUST
	bool "mv_cust"
	help
	  Builds mv_cust for Marvell boards
```

## package/mv_physdk/Config.in
```kconfig
config BR2_PACKAGE_MV_PHYSDK
  bool "mv_physdk"
  depends on !BR2_PACKAGE_GOOGLE_OPENBOX
  help
    Builds Marvell's MTD SDK for 88X32xx, 88X33xx, & 88X23xx PHYs as a static library, and installs
    the library plus the relevant headers into the staging sysroot as /usr/lib/libmvphysdk.a and in
    /usr/include/mvphysdk/, respectively.
```

## package/nmap/Config.in
```kconfig
config BR2_PACKAGE_NMAP
	bool "nmap"
	default n
	select BR2_PACKAGE_PCRE
	select BR2_PACKAGE_LUA
	help
	  Install the nmap package
```

## package/openjdk-bin/Config.in
```kconfig
config BR2_PACKAGE_OPENJDK_BIN
	bool "openjdk (precompiled glibc binaries)"
	depends on BR2_x86_64
	depends on BR2_TOOLCHAIN_EXTERNAL_GLIBC
	help
	  Precompiled openjdk runtime based on the openjdk debian packages.
```
