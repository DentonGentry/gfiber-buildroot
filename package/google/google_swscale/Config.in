## package/google/google_swscale/Config.in
```kconfig
config BR2_PACKAGE_GOOGLE_SWSCALE
        bool "google_swscale"
        help
          Builds the swscale library
```

## package/google/google_ts_check/Config.in
```kconfig
config BR2_PACKAGE_GOOGLE_TS_CHECK
        bool "google_ts_check"
        help
          Builds the ts stream checking and monitoring tool 
```

## package/google/google_vc/Config.in
```kconfig
config BR2_PACKAGE_GOOGLE_VC
	bool "google_vc"
	help
	  Google video conference.
```

## package/google/google_widevine/Config.in
```kconfig
config BR2_PACKAGE_GOOGLE_WIDEVINE
        bool "google_widevine"
        help
          Installs the widevine libraries
```

## package/google/google_wipg/Config.in
```kconfig
config BR2_PACKAGE_GOOGLE_WIPG
  bool "Enable Wireless Infrastructure Products Group (WIPG) packages"
  default n

menu "WIPG packages"
  depends on BR2_PACKAGE_GOOGLE_WIPG

config BR2_PACKAGE_GOOGLE_WIPG_MACSEC
  bool "MACsec abstraction layer"
  default n
  select BR2_PACKAGE_MV_PHYSDK
  help
    MACsec abstraction layer on top of Marvell's MTD SDK.

config BR2_PACKAGE_GOOGLE_WIPG_PHYTOOL
  bool "phytool"
  default n
  select BR2_PACKAGE_MV_PHYSDK
  help
    phytool is used on PTP devices to interact with Marvell PHY chips
    through the Marvell MTD SDK.

endmenu
```

## package/google/jtux/Config.in
```kconfig
config BR2_PACKAGE_GOOGLE_JTUX
        bool "google_jtux"
        help
          Builds the jtux library
```

## package/google/libjingle/Config.in
```kconfig
config BR2_PACKAGE_GOOGLE_LIBJINGLE
	bool "libjingle"
	help
	  libjingle is the Google Talk Voice and P2P Interoperability Library.

	  http://code.google.com/p/libjingle
```

## package/google/logupload/Config.in
```kconfig
config BR2_PACKAGE_GOOGLE_LOGUPLOAD
	bool "google_logupload"
	help
	  Tools for periodically uploading log files to a server.
```

## package/google/sagejni/Config.in
```kconfig
config BR2_PACKAGE_GOOGLE_SAGEJNI
        bool "google_sagejni"
        help
          Builds the SageTV operating system interface library
```

## package/google/sageserver/Config.in
```kconfig
config BR2_PACKAGE_GOOGLE_SAGESERVER
        bool "google_sageserver"
        select BR2_PACKAGE_GOOGLE_SKELMIR
        help
          Installs the SageTV server package
```

## package/google/tvstreamparser/Config.in
```kconfig
config BR2_PACKAGE_GOOGLE_TVSTREAMPARSER
        bool "google_tvstreamparser"
        help
          Builds the tv stream parser library
```

## package/google/vmlinuz/Config.in
```kconfig
config BR2_PACKAGE_GOOGLE_VMLINUZ
	bool "google_vmlinuz"
	help
	  Package kernel for Google platforms
```

## package/google/webrtc/Config.in
```kconfig
config BR2_PACKAGE_GOOGLE_WEBRTC
	bool "google_webrtc"
	help
	  webrtc is the software codec for Google Talk Voice and Video.
```

## package/google_cast/Config.in
```kconfig
config BR2_PACKAGE_GOOGLE_CAST
	bool "Build Google Cast package"
	select BR2_PACKAGE_BCM_COMMON
	select BR2_PACKAGE_BCM_ROCKFORD
	select BR2_PACKAGE_LIBCAP
	select BR2_PACKAGE_LIBNSS
	select BR2_PACKAGE_NINJA
```

## package/googletest/Config.in
```kconfig
config BR2_PACKAGE_GOOGLETEST
	bool "googletest"
	help
	  GTest unit testing framework and GMock mocking framework.
          (Formerly separate projects)

	  https://github.com/google/googletest

	depends on BR2_USE_WCHAR
	depends on BR2_TOOLCHAIN_HAS_THREADS
	depends on BR2_INSTALL_LIBSTDCPP
	depends on BR2_USE_MMU # fork()
```

## package/grpc/Config.in
```kconfig
config BR2_PACKAGE_GRPC
	bool "grpc"
	depends on BR2_PACKAGE_GOOGLE_GFLAGS
	depends on BR2_PACKAGE_OPENSSL
	depends on BR2_PACKAGE_PROTOBUF
	depends on BR2_PACKAGE_ZLIB
	help
	  A language-neutral, platform-neutral, open source, remote
	  procedure call (RPC) system initially developed at Google.

	  http://github.com/grpc/grpc
```

## package/gyp/Config.in
```kconfig
config BR2_PACKAGE_GYP
	bool "gyp"
	help
	  Gyp is a generator of build files for different platforms

	  https://code.google.com/p/gyp/
```

## package/harfbuzz/Config.in
```kconfig
config BR2_PACKAGE_HARFBUZZ
	bool "harfbuzz"
	help
	  OpenType text shaping engine

	  http://harfbuzz.org

comment "No comment yet"
```

## package/hfw/Config.in
```kconfig
menu "HFW (Athena Wireless) libraries and applications"
source "package/hfw/hfw_glaukus_hal/Config.in"
source "package/hfw/hfw_glaukus_linkman/Config.in"
source "package/hfw/hfw_glaukus_protobuf/Config.in"
source "package/hfw/hfw_surprise_diagnostics/Config.in"
endmenu
```

## package/hfw/hfw_glaukus_hal/Config.in
```kconfig
config BR2_PACKAGE_HFW_GLAUKUS_HAL
	bool hfw_glaukus_hal
	default n
	help
	  HFW_GLAUKUS_HAL
```

## package/hfw/hfw_glaukus_linkman/Config.in
```kconfig
config BR2_PACKAGE_HFW_GLAUKUS_LINKMAN
	bool hfw_glaukus_linkman
	default n
	help
	  HFW_GLAUKUS_LINKMAN
```

## package/hfw/hfw_glaukus_protobuf/Config.in
```kconfig
config BR2_PACKAGE_HFW_GLAUKUS_PROTOBUF
	bool hfw_glaukus_protobuf
	default n
	help
	  HFW_GLAUKUS_PROTOBUF
```

## package/hfw/hfw_surprise_diagnostics/Config.in
```kconfig
config BR2_PACKAGE_HFW_SURPRISE_DIAGNOSTICS
	bool hfw_surprise_diagnostics
	default n
	help
	  HFW_SURPRISE_DIAGNOSTICS
```

## package/hostapd-quantenna/Config.in
```kconfig
config BR2_PACKAGE_HOSTAPD_QUANTENNA
	bool "hostapd-quantenna"
	select BR2_PACKAGE_LIBNL
	help
	  User space daemon for wireless access points.

	  It implements IEEE 802.11 access point management,
	  IEEE 802.1X/WPA/WPA2/EAP authenticators, RADIUS client,
	  EAP server and RADIUS authentication server.

	  http://hostap.epitest.fi/

config BR2_PACKAGE_HOSTAPD_QUANTENNA_EAP
	bool "Enable EAP"
	depends on BR2_PACKAGE_HOSTAPD_QUANTENNA
	help
	  Enable support for EAP and RADIUS.

config BR2_PACKAGE_HOSTAPD_QUANTENNA_WPS
	bool "Enable WPS"
	depends on BR2_PACKAGE_HOSTAPD_QUANTENNA
	help
	  Enable support for Wi-Fi Protected Setup.
```

## package/humax_misc/Config.in
```kconfig
config BR2_PACKAGE_HUMAX_MISC
	bool "humax_misc"
	help
	  Library for manipulating humax data structures
```
