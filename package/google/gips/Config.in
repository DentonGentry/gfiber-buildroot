## package/google/gips/Config.in
```kconfig
config BR2_PACKAGE_GOOGLE_GIPS
	bool "google_gips"
	help
	  gips is the software codec for Google Talk Voice.
```

## package/google/google_buffet/Config.in
```kconfig
config BR2_PACKAGE_GOOGLE_BUFFET
       bool "google_buffet"
       default n
       help
         Google's Buffet
config BR2_PACKAGE_GOOGLE_BUFFET_DEMOS
       bool "google_buffet_demos"
       default n
       help
         Google's Buffet demos
```

## package/google/google_cast/Config.in
```kconfig
config BR2_PACKAGE_GOOGLE_CAST
	bool "Build Google Cast package"
	select BR2_PACKAGE_BCM_COMMON
	select BR2_PACKAGE_BCM_ROCKFORD
	select BR2_PACKAGE_CAIRO
	select BR2_PACKAGE_FONTCONFIG
	select BR2_PACKAGE_GOOGLE_WIDEVINE_CENC
	select BR2_PACKAGE_LIBCAP
	select BR2_PACKAGE_LIBNSS
	select BR2_PACKAGE_NINJA
```

## package/google/google_channel_srv/Config.in
```kconfig
config BR2_PACKAGE_GOOGLE_CHANNEL_SRV
        bool "google_channel_srv"
        help
          Builds channel service chsrv for servicing the off grid video streaming.
```

## package/google/google_chimera/Config.in
```kconfig
config BR2_PACKAGE_GOOGLE_CHIMERA
	bool "google_chimera"
	default n
	select BR2_PACKAGE_GO_GLOG
	select BR2_PACKAGE_GO_GOLUA
	select BR2_PACKAGE_GO_GRPC
	select BR2_PACKAGE_GO_LUAR
	select BR2_PACKAGE_GO_NET
	select BR2_PACKAGE_GO_PROTOBUF
	select BR2_PACKAGE_LUA
	select BR2_PACKAGE_MV_CPSS
	select BR2_PACKAGE_MV_PHYSDK
	help
	  Google's Chimera
```

## package/google/google_cryptohome/Config.in
```kconfig
config BR2_PACKAGE_GOOGLE_CRYPTOHOME
       bool "google_cryptohome"
       default n
       select BR2_PACKAGE_GOOGLE_BUFFET
       help
         Google's Cryptohome
```

## package/google/google_dart_vm/Config.in
```kconfig
config BR2_PACKAGE_GOOGLE_DART_VM
	bool "google_dart_vm"
	help
	  Builds the Dart Virtual Machine and runtime
```

## package/google/google_dashplayer/Config.in
```kconfig
config BR2_PACKAGE_GOOGLE_DASHPLAYER
	bool "Build dash player package"
	select BR2_PACKAGE_LIBXML2
	select BR2_PACKAGE_LIBCURL
	select BR2_PACKAGE_NINJA
```

## package/google/google_fallocate/Config.in
```kconfig
config BR2_PACKAGE_GOOGLE_FALLOCATE
        bool "google_fallocate"
        help
          Builds the fallocate library
```

## package/google/google_ffmpeg/Config.in
```kconfig
config BR2_PACKAGE_GOOGLE_FFMPEG
        bool "google_ffmpeg"
        help
          Builds the FFMPEG version with SageTV patch
```

## package/google/google_fiber_cast_controller/Config.in
```kconfig
config BR2_PACKAGE_GOOGLE_FIBER_CAST_CONTROLLER
	bool "Google Fiber Cast Controller"
	default n
	help
	  Build the Fiber Cast Controller for Google Fiber devices.
```

## package/google/google_freetypejni/Config.in
```kconfig
config BR2_PACKAGE_GOOGLE_FREETYPEJNI
        bool "google_freetypejni"
        select BR2_PACKAGE_FREETYPE
        help
          Builds the Freetype interface library
```

## package/google/google_frobnicast/Config.in
```kconfig
config BR2_PACKAGE_GOOGLE_FROBNICAST
        bool "google_frobnicast"
        depends on BR2_PACKAGE_GOOGLE_MCASTCAPTURE
        help
          Builds the Frobnicast client to provide TV outside of the Fiber network
```

## package/google/google_gcm/Config.in
```kconfig
config BR2_PACKAGE_GOOGLE_GCM
	bool "google_gcm"
	default n
	select BR2_PACKAGE_GO_GLOG
	select BR2_PACKAGE_GO_GOCZMQ
	select BR2_PACKAGE_GO_PROTOBUF
	help
	  Google's GCM
```

## package/google/google_gfex250/Config.in
```kconfig
config BR2_PACKAGE_GOOGLE_GFEX250
	bool "google_gfex250"
  select BR2_ROOTFS_SKELETON_CUSTOM
	help
	  Configuration for GFEX250
```

## package/google/google_gflags/Config.in
```kconfig
config BR2_PACKAGE_GOOGLE_GFLAGS
	bool "google_gflags"
	help
	  gflags is a library that implements commandline flags processing

	  https://code.google.com/p/gflags/
```

## package/google/google_gfrm200/Config.in
```kconfig
config BR2_PACKAGE_GOOGLE_GFRM200
	bool "google_gfrm200"
	help
	  Firmware for GFRM200
```

## package/google/google_gl_dart/Config.in
```kconfig
config BR2_PACKAGE_GOOGLE_GL_DART
        bool "google_gl_dart"
  depends on BR2_PACKAGE_BCM_ROCKFORD
  depends on BR2_PACKAGE_GOOGLE_DART_VM
  depends on BR2_PACKAGE_GOOGLE_MINICLIENT
	help
          Builds the Dart GL bindings
```

## package/google/google_glfw_dart/Config.in
```kconfig
config BR2_PACKAGE_GOOGLE_GLFW_DART
        bool "google_glfw_dart"
  depends on BR2_PACKAGE_BCM_COMMON
  depends on BR2_PACKAGE_GOOGLE_GLFW_NEXUS
  depends on BR2_PACKAGE_GOOGLE_DART_VM
	help
          Builds the Dart GLFW bindings
```

## package/google/google_glfw_nexus/Config.in
```kconfig
config BR2_PACKAGE_GOOGLE_GLFW_NEXUS
        bool "google_glfw_nexus"
	select BR2_PACKAGE_BCM_ROCKFORD
	depends on BR2_PACKAGE_GOOGLE_MINICLIENT
	help
          Builds the GLFW with Nexus backend
```

## package/google/google_glog/Config.in
```kconfig
config BR2_PACKAGE_GOOGLE_GLOG
	bool "google_glog"
	select BR2_PACKAGE_GOOGLE_GFLAGS
	help
	  Enables Glog library
```

## package/google/google_hdcp/Config.in
```kconfig
config BR2_PACKAGE_GOOGLE_HDCP
        bool "google_hdcp"
        help
          HDCP library.
```

## package/google/google_hdhomerun_plugin/Config.in
```kconfig
config BR2_PACKAGE_GOOGLE_HDHOMERUN_PLUGIN
        bool "google_hdhomerun_plugin"
        help
          Builds hdhomerun plugin that turns a hdhomerun tuner into a video streaming source.
```

## package/google/google_hnvram/Config.in
```kconfig
config BR2_PACKAGE_GOOGLE_HNVRAM
	bool "google_hnvram"
	select BR2_PACKAGE_HUMAX_MISC
	help
	  NVRAM manipulation utility for Google platforms.
```
