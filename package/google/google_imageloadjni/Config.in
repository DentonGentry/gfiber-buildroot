## package/google/google_imageloadjni/Config.in
```kconfig
config BR2_PACKAGE_GOOGLE_IMAGELOADJNI
        bool "google_imageloadjni"
        select BR2_PACKAGE_LIBPNG
        select BR2_PACKAGE_JPEG
        select BR2_PACKAGE_LIBUNGIF
        select BR2_PACKAGE_TIFF
        help
          Builds the image loading interface library
```

## package/google/google_keystore_client/Config.in
```kconfig
config BR2_PACKAGE_GOOGLE_KEYSTORE_CLIENT
	bool "google_keystore_client"
	help
	  Keystore client for Google Fiber

	  This is a client that is used to pull keys used by
	  Google Fiber from Keystore in production.
```

## package/google/google_libgep/Config.in
```kconfig
config BR2_PACKAGE_GOOGLE_LIBGEP
        bool "google_libgep"
        select BR2_PACKAGE_PROTOBUF
        help
          Builds the libgep libraries (libgepclient.a, libgepserver.a)
```

## package/google/google_libjingle/Config.in
```kconfig
config BR2_PACKAGE_GOOGLE_LIBJINGLE
	bool "google_libjingle"
	help
	  libjingle is the Google Talk Voice and P2P Interoperability Library.

	  http://code.google.com/p/libjingle
```

## package/google/google_licenses/Config.in
```kconfig
config BR2_PACKAGE_GOOGLE_LICENSES
	bool "google_licenses"
	select BR2_PACKAGE_GOOGLE_KEYSTORE_CLIENT
	help
	  Fetch licenses to install for Bruno
```

## package/google/google_mcastcapture/Config.in
```kconfig
config BR2_PACKAGE_GOOGLE_MCASTCAPTURE
        bool "google_mcastcapture"
        select BR2_PACKAGE_OPENSSL
        select BR2_PACKAGE_LIBCURL
        select BR2_PACKAGE_PROTOBUF
        help
          Builds the mcastcapture sagesrv binary and libptsindex.so library
```

## package/google/google_media/Config.in
```kconfig
config BR2_PACKAGE_GOOGLE_MEDIA
        bool "google_media"
        help
          Includes visual media (wallpapers, etc.)
```

## package/google/google_miniclient/Config.in
```kconfig
config BR2_PACKAGE_GOOGLE_MINICLIENT
        bool "google_miniclient"
	select BR2_PACKAGE_BCM_ROCKFORD
	select BR2_PACKAGE_GOOGLE_WIDEVINE
	select BR2_PACKAGE_GOOGLE_HDCP
	select BR2_PACKAGE_LIBXML2
	select BR2_PACKAGE_LIBCURL
	select BR2_PACKAGE_LIBUNGIF
	help
          Builds the SageTV miniclient
```

## package/google/google_mobile_api/Config.in
```kconfig
config BR2_PACKAGE_GOOGLE_MOBILE_API
	bool "google_mobile_api"
	help
	  GFTV remote API plug-in for Android and iOS apps
```

## package/google/google_mpegparser/Config.in
```kconfig
config BR2_PACKAGE_GOOGLE_MPEGPARSER
        bool "google_mpegparser"
        help
          Builds the MPEG Parser interface library
```

## package/google/google_ookla/Config.in
```kconfig
config BR2_PACKAGE_GOOGLE_OOKLA
    bool "google_ookla"
    select BR2_PACKAGE_POCO
    select BR2_PACKAGE_POCO_UTIL
    select BR2_PACKAGE_POCO_NET
    select BR2_PACKAGE_POCO_XML
    help
      Installs the Ookla Speedtest
```

## package/google/google_oregano/Config.in
```kconfig
config BR2_PACKAGE_GOOGLE_OREGANO
	bool "google_oregano"
	select BR2_PACKAGE_GOOGLE_DART_VM
	select BR2_PACKAGE_GOOGLE_OREGANO_NATIVE
	help
	  Include the utilities for supporting Oregano (Marjoram & Basil)
```

## package/google/google_oregano_native/Config.in
```kconfig
config BR2_PACKAGE_GOOGLE_OREGANO_NATIVE
	bool "google_oregano_native"
	select BR2_PACKAGE_GOOGLE_DART_VM
	select BR2_PACKAGE_GOOGLE_GL_DART if BR2_mipsel
	select BR2_PACKAGE_GOOGLE_GLFW_DART if BR2_mipsel
	help
	  Native extensions for Oregano projects.
```

## package/google/google_platform/Config.in
```kconfig
config BR2_PACKAGE_GOOGLE_PLATFORM
	bool "Google platform tools"
	default n
	help
	  Include some tools designed for running on the Google Fiber
	  devices.

config BR2_PACKAGE_GOOGLE_PLATFORM_BASE
	bool "Google platform dependencies"
	default n
	select BR2_PACKAGE_FREEGREP
	select BR2_PACKAGE_PROCPS
	select BR2_PACKAGE_LOCKFILE_PROGS
	select BR2_PACKAGE_SYSVINIT
	select BR2_PACKAGE_S6_RC
	select BR2_PACKAGE_GOOGLE_SIGNING
	select BR2_PACKAGE_CURL
	select BR2_PACKAGE_SED
	select BR2_PACKAGE_TLSDATE
	select BR2_PACKAGE_CLOCKSPEED
	select BR2_PACKAGE_LIBCARES
	select BR2_PACKAGE_UTIL_LINUX_SCHEDUTILS
	select BR2_PACKAGE_LIBJSONCPP
	select BR2_PACKAGE_GPERF
	select BR2_PACKAGE_PY_TORNADO
	select BR2_PACKAGE_MICROPYTHON
	select BR2_PACKAGE_MICROPYTHON_LIB
	help
	  This package is a placeholder that depends on other packages needed
	  to run the Google Fiber devices.

config BR2_PACKAGE_GOOGLE_PLATFORM_DVBUTILS
	bool "include dvb tools"
	default n
	help
	  DVB utility tools.

config BR2_PACKAGE_GOOGLE_PLATFORM_CRYPTDEV
	bool "include cryptdev"
	default n
	help
	  dm-crypt setup tool.

config BR2_PACKAGE_GOOGLE_PLATFORM_HNVRAM
	bool "include hnvram access tools"
	default n
	select BR2_PACKAGE_HUMAX_MISC
	help
	  NVRAM manipulation utility for Google platforms.

config BR2_PACKAGE_GOOGLE_PLATFORM_WAVEGUIDE
	bool "include waveguide tool"
	default n
	help
	  Waveguide tool for Wi-Fi.

config BR2_PACKAGE_GOOGLE_PLATFORM_CACHE_WARMING
        bool "include cache warming"
        default n
        help
          Periodically fetches top requested hosts.

config BR2_PACKAGE_GOOGLE_PLATFORM_LOGUPLOAD
	bool "include log upload tool"
	default n
	help
	  Log upload tool for Google platforms.

config BR2_PACKAGE_GOOGLE_PLATFORM_SYSMGR
	bool "include system manager"
	default n
	help
	  System manager.

config BR2_PACKAGE_GOOGLE_PLATFORM_JSONPOLL
	bool "include jsonpoll tool"
	help
	  Include the jsonpoll tool used by PTP devices to poll data
	  from the modem and radio to be exported via catawampus.

config BR2_PACKAGE_GOOGLE_PLATFORM_CRAFTUI
	bool "include craftui"
	select BR2_PACKAGE_CATAWAMPUS
	help
	  Include the craftui web server used by PTP devices for
	  site configuration.

config BR2_PACKAGE_GOOGLE_PLATFORM_PRESTERASTATS
	bool "include presterastats tool"
	help
	  Include the presterastats tool used by PTP devices to
	  extract data from the on-board prestera switch

config BR2_PACKAGE_GOOGLE_PLATFORM_LEDPATTERN
	bool "include ledpattern"
	help
	  Include the ledpattern tool.

config BR2_PACKAGE_GOOGLE_OPENBOX
	bool "Openbox Release"
	default n
	help
	  Build google openbox release, using the openbox (unlocked)
	  bootloader.

config BR2_PACKAGE_GOOGLE_PROD
	bool "Production Release"
	depends on !BR2_PACKAGE_GOOGLE_OPENBOX
	select BR2_PACKAGE_BCM_SIGNING if BR2_mipsel
	select BR2_PACKAGE_BCM_BOLT_SIGNING if BR2_PACKAGE_BCM_COMMON_PLATFORM = 97439
	help
	  Build google production release, using the signed/locked bootloader.

config BR2_PACKAGE_GOOGLE_UNSIGNED
	bool "Unsigned Release"
	default n
	help
	  Prevent signing workflows from being executed to allow post-build signing.

config BR2_PACKAGE_GOOGLE_KEY_SUFFIX
	string "Signing key suffix"
	help
	  Suffix to select a different set of signing keys.

config BR2_PACKAGE_GOOGLE_PLATFORM_CONNECTION_MANAGER
	bool "include connection manager"
	default n
	select BR2_PACKAGE_PY_INOTIFY
	select BR2_PACKAGE_PY_WPACTRL
	help
	  Connection manager for devices which can operate entirely over Wi-Fi.

config BR2_PACKAGE_GOOGLE_TEST
	bool "Include Test Packages"
	default n
	depends on !(BR2_PACKAGE_GOOGLE_PROD && BR2_PACKAGE_GOOGLE_SPACECAST)
	select BR2_PACKAGE_BONNIE
	select BR2_PACKAGE_CRASHME
	select BR2_PACKAGE_DHRYSTONE
	select BR2_PACKAGE_DROPBEAR
	select BR2_PACKAGE_DROPBEAR_SMALL
	select BR2_PACKAGE_DROPBEAR_DISABLE_REVERSEDNS
	select BR2_PACKAGE_LESS
	select BR2_PACKAGE_NANO
	select BR2_PACKAGE_ZSH
	select BR2_PACKAGE_ZSH_BINARIES_ONLY
	select BR2_PACKAGE_ETHTOOL
	select BR2_PACKAGE_FIO
	select BR2_PACKAGE_IPERF
	select BR2_PACKAGE_IPERF3
	select BR2_PACKAGE_LMBENCH
	select BR2_PACKAGE_MEMSTAT
	select BR2_PACKAGE_MEMTESTER
	select BR2_PACKAGE_NETPERF
	select BR2_PACKAGE_RSYNC
	select BR2_PACKAGE_SSHFS
	select BR2_PACKAGE_STRACE
	select BR2_PACKAGE_TCPDUMP
	select BR2_PACKAGE_TCPDUMP_SMB
	select BR2_PACKAGE_UTIL_LINUX_LOGIN_UTILS
	select BR2_PACKAGE_UTIL_LINUX_AGETTY
	select BR2_PACKAGE_WHETSTONE
	select BR2_PACKAGE_SDPARM
	select BR2_PACKAGE_SYSSTAT
	select BR2_PACKAGE_TESTUSB
	select BR2_PACKAGE_TRACEROUTE_NEW
	help
	  Enable packages for test.

config BR2_PACKAGE_GOOGLE_PLATFORM_ONLY
	bool "Disable all application-level code"
	default n
	help
	  This meta-package disables Fiber Jack, Network Box, Storage Box,
	  and TV Box functionality, leaving only the core operating system.
	  (It works because other packages depend on !GOOGLE_PLATFORM_ONLY.)

config BR2_PACKAGE_GOOGLE_FIBER_JACK
	bool "Device can act as Google Fiber Jack"
	default n
	depends on !BR2_PACKAGE_GOOGLE_PLATFORM_ONLY
	select BR2_PACKAGE_IFPLUGD
	select BR2_PACKAGE_PROTOBUF
	select BR2_PACKAGE_PROTOBUF_ONLY_LITE

config BR2_PACKAGE_GOOGLE_NETWORK_BOX
	bool "Device can act as Google Fiber Network Box"
	default n
	depends on !BR2_PACKAGE_GOOGLE_PLATFORM_ONLY
	select BR2_PACKAGE_IFPLUGD
	select BR2_PACKAGE_PROTOBUF
	select BR2_PACKAGE_INADYN
	select BR2_PACKAGE_LIBGLIB2
	select BR2_PACKAGE_GOOGLE_GCM

config BR2_PACKAGE_GOOGLE_SPACECAST
	bool "Device can act as Google SpaceCast Box"
	default n
	depends on !BR2_PACKAGE_GOOGLE_PLATFORM_ONLY
	select BR2_PACKAGE_PROTOBUF

config BR2_PACKAGE_GOOGLE_WINDCHARGER
	bool "Device can act as Google WindCharger Box"
	default n
	depends on !BR2_PACKAGE_GOOGLE_PLATFORM_ONLY
	select BR2_PACKAGE_IFPLUGD
	select BR2_PACKAGE_INADYN
	select BR2_PACKAGE_LIBGLIB2

config BR2_PACKAGE_GOOGLE_STORAGE_BOX
	bool "Device can act as Google Fiber Storage Box"
	default n
	depends on !BR2_PACKAGE_GOOGLE_PLATFORM_ONLY
	select BR2_PACKAGE_GOOGLE_CHANNEL_SRV
	select BR2_PACKAGE_GOOGLE_DVBCAPTURE
	select BR2_PACKAGE_GOOGLE_HDHOMERUN_PLUGIN
	select BR2_PACKAGE_GOOGLE_LIBGEP
	select BR2_PACKAGE_GOOGLE_MCASTCAPTURE
	select BR2_PACKAGE_GOOGLE_MEDIA
	select BR2_PACKAGE_GOOGLE_MPEGPARSER
	select BR2_PACKAGE_GOOGLE_OOKLA if BR2_mipsel
	select BR2_PACKAGE_GOOGLE_OREGANO if !BR2_x86_64
	select BR2_PACKAGE_GOOGLE_TS_CHECK
	select BR2_PACKAGE_GOOGLE_TVSTREAMPARSER
	select BR2_PACKAGE_AVAHI
	select BR2_PACKAGE_AVAHI_DAEMON
	select BR2_PACKAGE_SAMBA
	select BR2_PACKAGE_SAMBA_NMBLOOKUP
	select BR2_PACKAGE_AVAHI_COMPAT_LIBDNS_SD
	select BR2_PACKAGE_PROTOBUF
	select BR2_PACKAGE_GOOGLE_FROBNICAST

config BR2_PACKAGE_GOOGLE_TV_BOX
	bool "Device can act as Google Fiber TV Box"
	default n
	depends on !BR2_PACKAGE_GOOGLE_PLATFORM_ONLY
	select BR2_PACKAGE_GOOGLE_CAST
	select BR2_PACKAGE_GOOGLE_DASHPLAYER
	select BR2_PACKAGE_GOOGLE_DIAL
	select BR2_PACKAGE_GOOGLE_DVBCAPTURE
	select BR2_PACKAGE_GOOGLE_FREETYPEJNI
	select BR2_PACKAGE_GOOGLE_GFRM200
	select BR2_PACKAGE_GOOGLE_IMAGELOADJNI
	select BR2_PACKAGE_GOOGLE_JTUX
	select BR2_PACKAGE_GOOGLE_LIBGEP
	select BR2_PACKAGE_GOOGLE_LICENSES if BR2_mipsel
	select BR2_PACKAGE_GOOGLE_MEDIA
	select BR2_PACKAGE_GOOGLE_MINICLIENT
	select BR2_PACKAGE_GOOGLE_MOBILE_API
	select BR2_PACKAGE_GOOGLE_MPEGPARSER
	select BR2_PACKAGE_GOOGLE_OOKLA if BR2_mipsel
	select BR2_PACKAGE_GOOGLE_OREGANO
	select BR2_PACKAGE_GOOGLE_PULLREADER
	select BR2_PACKAGE_GOOGLE_TVSTREAMPARSER
	select BR2_PACKAGE_CHROMIUM
	select BR2_PACKAGE_LIBXSLT
	select BR2_PACKAGE_BCM_BSEAV
	select BR2_PACKAGE_BCM_NEXUS
	select BR2_PACKAGE_BCM_NETFLIX if BR2_mipsel
	select BR2_PACKAGE_BCM_VUDU if BR2_mipsel
	select BR2_PACKAGE_IFPLUGD
	select BR2_PACKAGE_LIBPROJECTM
	select BR2_PACKAGE_BOOST
	select BR2_PACKAGE_AVAHI
	select BR2_PACKAGE_AVAHI_DAEMON
	select BR2_PACKAGE_AVAHI_COMPAT_LIBDNS_SD
	select BR2_PACKAGE_PROTOBUF
```

## package/google/google_platform_base/Config.in
```kconfig
config BR2_PACKAGE_GOOGLE_PLATFORM_BASE
	bool "google_platform_base"
	help
	  The platform base.
```

## package/google/google_platform_sysmgr/Config.in
```kconfig
config BR2_PACKAGE_GOOGLE_PLATFORM_SYSMGR
	bool "google_platform_sysmgr"
	help
	  The platform sysmgr.
```

## package/google/google_prism/Config.in
```kconfig
config BR2_PACKAGE_GOOGLE_PRISM
	bool "google_prism"
	default n
	help
	  Include some tools designed for running on Google Prism devices.
```

## package/google/google_pullreader/Config.in
```kconfig
config BR2_PACKAGE_GOOGLE_PULLREADER
        bool "google_pullreader"
        select BR2_PACKAGE_GOOGLE_FFMPEG
        depends on !BR2_PACKAGE_GOOGLE_PLATFORM_ONLY
        help
          Builds the SageTV pullreader
```

## package/google/google_sage_analytics_plugin/Config.in
```kconfig
config BR2_PACKAGE_GOOGLE_SAGE_ANALYTICS_PLUGIN
	bool "google_sage_analytics_plugin"
	help
	  Sage plug-in for Google Fiber Analytics usage logging.
```

## package/google/google_sageserver/Config.in
```kconfig
config BR2_PACKAGE_GOOGLE_SAGESERVER
        bool "google_sageserver"
        depends on BR2_PACKAGE_GOOGLE_SKELMIR || BR2_PACKAGE_OPENJDK_BIN
        select BR2_PACKAGE_GOOGLE_MOBILE_API
	select BR2_PACKAGE_GOOGLE_SAGE_ANALYTICS_PLUGIN
        help
          Installs the SageTV server package
```

## package/google/google_signing/Config.in
```kconfig
config BR2_PACKAGE_GOOGLE_SIGNING
	bool "google_signing"
	select BR2_PACKAGE_GOOGLE_KEYSTORE_CLIENT
	select BR2_PACKAGE_PY_OPENSSL
	help
	  Signing checker for Google platforms.
```

## package/google/google_skelmir/Config.in
```kconfig
config BR2_PACKAGE_GOOGLE_SKELMIR
        bool "google_skelmir"
        depends on !BR2_PACKAGE_GOOGLE_PLATFORM_ONLY
        help
          Installs the Skelmir Java VM
```

## package/google/google_spacecast/Config.in
```kconfig
config BR2_PACKAGE_GOOGLE_SPACECAST
	bool "google_spacecast"
	default n
	select BR2_PACKAGE_GO_CRON
	select BR2_PACKAGE_GO_FSNOTIFY
	select BR2_PACKAGE_GO_GLOG
	select BR2_PACKAGE_GO_GODBUS_DBUS
	select BR2_PACKAGE_GO_GONZOJIVE_MDNS
	select BR2_PACKAGE_GO_GOOGLE_API
	select BR2_PACKAGE_GO_GRPC
	select BR2_PACKAGE_GO_MIEKG_DNS
	select BR2_PACKAGE_GO_NET
	select BR2_PACKAGE_GO_OAUTH2
	select BR2_PACKAGE_GO_PROTOBUF
	select BR2_PACKAGE_GO_SHANEMHANSEN_GOSSL
	select BR2_PACKAGE_GO_TPM
	select BR2_PACKAGE_GOOGLE_WIDEVINE_CENC
	help
	  Google's Spacecast
```

## package/google/google_spicerack_migration/Config.in
```kconfig
config BR2_PACKAGE_GOOGLE_SPICERACK_MIGRATION
	bool "google_spicerack_migration"
	help
	  Plugin for migrating Sage accounts to Spicerack
```

## package/google/google_styleguide/Config.in
```kconfig
config BR2_PACKAGE_GOOGLE_STYLEGUIDE
	bool "Google styleguide (and CppLint)"
	default y
	help
	  Googles language styleguide repository.

	  Mostly useful for the cpplint tool contained within it, though other tools
	  may be added over time
```
