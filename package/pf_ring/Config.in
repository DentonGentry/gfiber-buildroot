## package/pf_ring/Config.in
```kconfig
config BR2_PACKAGE_PF_RING
    bool "pf_ring"
    help
      PF RING utility package
```

## package/prelink-cross/Config.in
```kconfig
config BR2_PACKAGE_PRELINK_CROSS
	bool "prelink-cross"
	help
	  Prelinking is the process of pre-computing the load addresses and link
	  tables generated by the dynamic linker as compared to doing this at
	  runtime. Doing this ahead of time results in performance improvements
	  when the application is launched.

	  By providing an emulated runtime dynamic linker, the cross-prelink
	  project extends the prelink software's ability to prelink a sysroot
	  environment. Additionally, the cross-prelink software enables the
	  ability to work in sysroot style environments.
```

## package/prism/Config.in
```kconfig
config BR2_PACKAGE_PRISM
	bool "Enable Prism Board"
	default y
	help
	  Customization for Prism boards.
```

## package/procps/Config.in
```kconfig
config BR2_PACKAGE_PROCPS
	bool "procps"
	help
	  Standard informational utilities and process-handling tools.
	  Provides things like kill, ps, uptime, free, top, etc...

	  http://procps.sourceforge.net/
```

## package/protobuf/Config.in
```kconfig
config BR2_PACKAGE_PROTOBUF
	bool "protobuf"
	depends on BR2_INSTALL_LIBSTDCPP
	depends on BR2_TOOLCHAIN_HAS_THREADS
	help
	  Protocol buffers are Google's language-neutral, platform-neutral,
	  extensible mechanism for serializing structured data.

	  http://code.google.com/p/protobuf/

comment "protobuf needs a toolchain w/ C++, threads"
	depends on !BR2_INSTALL_LIBSTDCPP || !BR2_TOOLCHAIN_HAS_THREADS


config BR2_PACKAGE_PROTOBUF_ONLY_LITE
	bool "only install libprotobuf-lite"
	depends on BR2_PACKAGE_PROTOBUF
	help
	  Do not install protoc or the full libproto on the target,
	  only install the libprotobuf-lite runtime library.

config BR2_PACKAGE_PROTOBUF_VERSION_VALUE
	string "Protobuf library version"
	default "3.0.0-beta-1"
```

## package/py/Config.in
```kconfig
menu "other python modules"

config BR2_PACKAGE_PY_GOOGLE_API
	bool "Google API"
	select BR2_PACKAGE_PYTHON_SETUPTOOLS
	select BR2_PACKAGE_PY_OAUTH2
	select BR2_PACKAGE_PY_URI_TEMPLATES
	select BR2_PACKAGE_PY_GFLAGS
	select BR2_PACKAGE_PY_HTTPLIB2

config BR2_PACKAGE_PY_OAUTH2
	bool "OAuth 2"
	select BR2_PACKAGE_PYTHON_SETUPTOOLS

config BR2_PACKAGE_PY_URI_TEMPLATES
	bool "URI Templates"
	select BR2_PACKAGE_PYTHON_SETUPTOOLS

config BR2_PACKAGE_PY_GFLAGS
	bool "Google Flags"
	select BR2_PACKAGE_PYTHON_SETUPTOOLS

config BR2_PACKAGE_PY_HTTPLIB2
	bool "HTTPLib2"
	select BR2_PACKAGE_PYTHON_SETUPTOOLS

config BR2_PACKAGE_PY_CURL
	bool "py-curl"
	select BR2_PACKAGE_LIBCURL
	select BR2_PACKAGE_PYTHON_SETUPTOOLS

config BR2_PACKAGE_PY_WPACTRL
	bool "wpa_supplicant control interface bindings"
	select BR2_PACKAGE_PYTHON_SETUPTOOLS
	depends on BR2_PACKAGE_PYTHON
	depends on BR2_PACKAGE_WPA_SUPPLICANT

source "package/py/py-dns/Config.in"
source "package/py/py-monotime/Config.in"
source "package/py/py-yaml/Config.in"
source "package/py/py-numpy/Config.in"
source "package/py/py-pympler/Config.in"

endmenu
```

## package/py/py-dns/Config.in
```kconfig
config BR2_PACKAGE_PY_DNS
	bool "py-dns"
	depends on BR2_PACKAGE_PYTHON
	help
      DNS toolkit for Python.

      http://www.dnspython.org/
```

## package/py/py-guppy/Config.in
```kconfig
config BR2_PACKAGE_PY_GUPPY
	bool "py-guppy"
	depends on BR2_PACKAGE_PYTHON
	help
	  Memory profiling tool for Python.
```

## package/py/py-inotify/Config.in
```kconfig
config BR2_PACKAGE_PY_INOTIFY
	bool "py-inotify"
	depends on BR2_PACKAGE_PYTHON
	help
	  py-inotify Python wrapper for Linux inotify
```

## package/py/py-monotime/Config.in
```kconfig
config BR2_PACKAGE_PY_MONOTIME
	bool "py-monotime"
	depends on BR2_PACKAGE_PYTHON
	help
	  py-monotime adds time.monotonic() in older python versions.
```

## package/py/py-pympler/Config.in
```kconfig
config BR2_PACKAGE_PY_PYMPLER
	bool "py-pympler"
	depends on BR2_PACKAGE_PYTHON
	help
      Pympler is a memory footprint analysis tool for Python.
      https://pythonhosted.org/Pympler/
```

## package/py/py-pyrad/Config.in
```kconfig
config BR2_PACKAGE_PY_PYRAD
	bool "py-pyrad"
	depends on BR2_PACKAGE_PYTHON
	help
	  py-pyrad is an implementation of a RADIUS client as described in RFC2865.
```

## package/py/py-yaml/Config.in
```kconfig
config BR2_PACKAGE_PY_YAML
	bool "py-yaml"
	select BR2_PACKAGE_LIBYAML
	depends on BR2_PACKAGE_PYTHON
	help
	  PyYAML is a YAML parser and emitter for Python.
```

## package/python-crypto/Config.in
```kconfig
config BR2_PACKAGE_PYTHON_CRYPTO
	bool "python-crypto"
	depends on BR2_PACKAGE_PYTHON
	select BR2_PACKAGE_GMP
	help
	  python-crypto is a Python crypto library.

	  https://www.dlitz.net/software/pycrypto
```

## package/python-gobject/Config.in
```kconfig
config BR2_PACKAGE_PYTHON_GOBJECT
	bool "python-gobject"
	depends on BR2_PACKAGE_PYTHON
	depends on BR2_USE_WCHAR
	select BR2_PACKAGE_LIBGLIB2
	help
	  Python bindings for GObject

	  https://wiki.gnome.org/action/show/Projects/PyGObject

comment "python-gobject requires a toolchain with WCHAR support"
	depends on BR2_PACKAGE_PYTHON && !BR2_USE_WCHAR
```

## package/python-pypcap/Config.in
```kconfig
config BR2_PACKAGE_PYTHON_PYPCAP
	bool "python-pypcap"
	depends on BR2_PACKAGE_PYTHON
	select BR2_PACKAGE_LIBPCAP
	help
	  The pypcap module is a object-oriented wrapper of the C libpcap library.

	  https://code.google.com/p/pypcap/
```

## package/python-pyrex/Config.in.host
```kconfig
config BR2_PACKAGE_HOST_PYTHON_PYREX 
	bool "python-pyrex (host tool)" 
	depends on BR2_PACKAGE_PYTHON 
	help 
	 Pyrex is a language for writing Python extension modules 
 
	 http://www.cosc.canterbury.ac.nz/greg.ewing/python/Pyrex/
```

## package/qca95xx/Config.in
```kconfig
config BR2_PACKAGE_QCA95XX
	bool "qca95xx"
	help
	  Builds qca95xx drivers and apps for WindCharger boards
```

## package/qualcomm_drivers/Config.in
```kconfig
menu "Qualcomm Drivers"
	config BR2_PACKAGE_QUALCOMM_DRIVERS
		bool "Enable Qualcomm drivers"
		default n
endmenu
```

## package/qualcomm_switch/Config.in
```kconfig
menu "Qualcomm Switch SDK"
	config BR2_PACKAGE_QUALCOMM_SWITCH
		bool "Qualcomm Ethernet Switch SDK"
		depends on !BR2_PACKAGE_GOOGLE_PLATFORM_ONLY
		default n
endmenu
```

## package/quantenna_drivers/Config.in
```kconfig
config BR2_PACKAGE_QUANTENNA_DRIVERS
	bool
	default n

choice
	prompt "Quantenna drivers"
	optional

	config BR2_PACKAGE_QUANTENNA_DRIVERS_PCIE_HOST
		bool "PCIe host"
		depends on !BR2_PACKAGE_GOOGLE_PLATFORM_ONLY
		select BR2_PACKAGE_QUANTENNA_DRIVERS

	config BR2_PACKAGE_QUANTENNA_DRIVERS_PCIE_MODULE
		bool "PCIe module"
		depends on !BR2_PACKAGE_GOOGLE_PLATFORM_ONLY
		select BR2_PACKAGE_QUANTENNA_DRIVERS

	config BR2_PACKAGE_QUANTENNA_DRIVERS_STANDALONE
		bool "Standalone"
		depends on !BR2_PACKAGE_GOOGLE_PLATFORM_ONLY
		select BR2_PACKAGE_QUANTENNA_DRIVERS
endchoice
```

## package/rsync/Config.in
```kconfig
config BR2_PACKAGE_RSYNC
	select BR2_PACKAGE_ATTR
	bool "rsync"
	help
	  File transfer program to keep remote files in sync.

	  http://rsync.samba.org/
```

## package/s6-rc/Config.in
```kconfig
config BR2_PACKAGE_S6_RC
	bool "s6-rc service manager suite"
	select BR2_PACKAGE_S6
	help
	  An s6-based service manager with features similar to systemd.

	  (But modular instead of monolithic.)

	  http://skarnet.org/software/s6-rc/
```

## package/s6/Config.in
```kconfig
config BR2_PACKAGE_S6
	bool "s6 process supervisor suite"
	select BR2_PACKAGE_EXECLINE
	help
	  A supervisor suite similar to djb daemontools.

	  http://skarnet.org/software/s6/
```

## package/sagetv/Config.in
```kconfig
menu "SageTV libraries and applications"
source "package/sagetv/ffmpeg/Config.in"
source "package/sagetv/miniclient/Config.in"
source "package/sagetv/pullreader/Config.in"
endmenu
```
