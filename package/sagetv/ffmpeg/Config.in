## package/sagetv/ffmpeg/Config.in
```kconfig
config BR2_PACKAGE_SAGETV_FFMPEG
        bool "sagetv_ffmpeg"
        help
          Builds the FFMPEG version with SageTV patch
```

## package/sagetv/miniclient/Config.in
```kconfig
config BR2_PACKAGE_SAGETV_MINICLIENT
        bool "sagetv_miniclient"
        help
          Builds the SageTV miniclient
```

## package/sagetv/pullreader/Config.in
```kconfig
config BR2_PACKAGE_SAGETV_PULLREADER
        bool "sagetv_pullreader"
        help
          Builds the SageTV pullreader
```

## package/simpleramfs/Config.in
```kconfig
config BR2_PACKAGE_SIMPLERAMFS
	bool "simpleramfs"
	select BR2_PACKAGE_TOYBOX
	select BR2_PACKAGE_TOOLBOX
	select BR2_PACKAGE_DASH
	select BR2_PACKAGE_UTIL_LINUX
	select BR2_PACKAGE_MTD
	select BR2_PACKAGE_LVM2 if !BR2_TARGET_ROOTFS_RECOVERYFS
	select BR2_PACKAGE_UTIL_LINUX_MOUNT
	depends on !BR2_TARGET_ROOTFS_INITRAMFS
	help
	  Generate the simplest possible initramfs for finding,
	  verifying, and mounting the squashfs that contains the "real"
	  root filesystem.

config BR2_PACKAGE_SIMPLERAMFS_LINKED_IN
	bool "Bake the simpleramfs into the kernel image."
	default y
	depends on BR2_PACKAGE_SIMPLERAMFS
	help
	  Turn the simpleramfs into the initramfs compiled into the kernel image.

if BR2_PACKAGE_SIMPLERAMFS

choice
	prompt "Compression algorithm"
	default BR2_PACKAGE_SIMPLERAMFS_GZIP
	depends on !BR2_PACKAGE_SIMPLERAMFS_LINKED_IN
	help
	  Select the compression algorithm for the simpleramfs image.

config BR2_PACKAGE_SIMPLERAMFS_GZIP
	bool "gzip"

config BR2_PACKAGE_SIMPLERAMFS_XZ
	bool "xz"

endchoice

endif
```

## package/simpleramfs_firmware/Config.in
```kconfig
config BR2_PACKAGE_SIMPLERAMFS_FIRMWARE
	bool "Include vendor firmware blobs used when boot with simpleramfs"

if BR2_PACKAGE_SIMPLERAMFS_FIRMWARE

config BR2_PACKAGE_SIMPLERAMFS_FIRMWARE_FILENAMES
	string "Simple RAMFS firmware filenames"
	default ""
	help
	  Space-separated list of filenames relative to /lib/firmware/

endif
```

## package/skalibs/Config.in
```kconfig
config BR2_PACKAGE_SKALIBS
	bool "skalibs libraries"
	help
	  Libraries needed for skarnet tools (such as s6).

	  http://skarnet.org/software/skalibs/
```

## package/sniproxy/Config.in
```kconfig
config BR2_PACKAGE_SNIPROXY
	bool "sniproxy"
	select BR2_PACKAGE_LIBEV
	select BR2_PACKAGE_PCRE
	select BR2_PACKAGE_UDNS
	help
	  Proxies incoming HTTP and TLS connections based on the hostname
	  contained in the initial request of the TCP session. This enables
	  HTTPS name-based virtual hosting to separate backend servers without
	  installing the private key on the proxy machine.

	  https://github.com/dlundquist/sniproxy
```

## package/sudo/Config.in
```kconfig
config BR2_PACKAGE_SUDO
	bool "sudo"
	help
	  Sudo is a program designed to allow a sysadmin to give
	  limited root privileges to users and log root activity.  The
	  basic philosophy is to give as few privileges as possible
	  but still allow people to get their work done.

	  http://www.sudo.ws/sudo/

if BR2_PACKAGE_SUDO
config BR2_PACKAGE_SUDO_ROOT_ONLY
	bool "Only the root user can run the sudo command"
	default n
	help
	  Restrict the use of the sudo command to the root user.
	  Especially on embedded systems it can be desirable to not
	  allow unprivileged users to acquire root access. Still sudo can
	  be useful on such systems to allow the root user to launch
	  daemons/programs with a different uid. The restriction is
	  enforced through file system permissions.
endif
```

## package/testusb/Config.in
```kconfig
config BR2_PACKAGE_TESTUSB
  bool "testusb"
  help
    Build user space testusb utility.
    http://www.linux-usb.org/usbtest/
```

## package/tlsdate/Config.in
```kconfig
config BR2_PACKAGE_TLSDATE
	bool "tlsdate"
	select BR2_PACKAGE_LIBEVENT
	help
	  tlsdate is a simple client that extracts the current time from
	  a TLS/SSL handshake.

	  https://github.com/ioerror/tlsdate/
```

## package/toybox/Config.in
```kconfig
config BR2_PACKAGE_TOYBOX
	bool "Toybox (busybox replacement)"
	depends on BR2_PACKAGE_BUSYBOX!=y
```

## package/trace-cmd/Config.in
```kconfig
config BR2_PACKAGE_TRACE_CMD
	bool "trace-cmd"
	help
	  trace-cmd is a command-line tool that works with Ftrace.

	  http://git.kernel.org/cgit/linux/kernel/git/rostedt/trace-cmd.git
```

## package/traceroute_new/Config.in
```kconfig
config BR2_PACKAGE_TRACEROUTE_NEW
	bool "traceroute_new"
	help
	  Traceroute utility for Linux.

	  http://traceroute.sourceforge.net/
```

## package/trousers/Config.in
```kconfig
config BR2_PACKAGE_TROUSERS
  bool "trousers"
  depends on BR2_PACKAGE_OPENSSL
  help
    The open-source TCG Software Stack.

    http://trousers.sourceforge.net/
```

## package/udns/Config.in
```kconfig
config BR2_PACKAGE_UDNS
	bool "udns"
	help
	  UDNS is a stub DNS resolver library with ability to perform both
	  syncronous and asyncronous DNS queries.

	  http://www.corpit.ru/mjt/udns.html
```

## package/vconfig/Config.in
```kconfig
config BR2_PACKAGE_VCONFIG
	bool "vconfig"
	help
	  VLAN configuration utilities vconfig and macvlan_config.

	  http://www.candelatech.com/~greear/vlan.html
```

## package/webp/Config.in
```kconfig
config BR2_PACKAGE_WEBP
	bool "webp"
	help
	  Library for loading WEBP images.

	  https://developers.google.com/speed/webp/
```

## package/zsh/Config.in
```kconfig
config BR2_PACKAGE_ZSH
	bool "zsh"
	help
	Zsh is a shell designed for interactive use, 
	although it is also a powerful scripting language

	http://zsh.sourceforge.net/

config BR2_PACKAGE_ZSH_BINARIES_ONLY
	bool "zsh binary only"
	help
	Only install the binary file to the target. This
	usually will save more space.
```

## toolchain/golang/Config.in
```kconfig
config BR2_TOOLCHAIN_GOLANG
	bool "Build Go language (golang) distribution"
	depends on BR2_arm || BR2_i386 || BR2_x86_64
	default n
	help
	  This is the Go language distribution.

	  http://golang.org

config BR2_TOOLCHAIN_GOLANG_CGO
	bool "Enable Cgo for Go language (golang)"
	depends on BR2_TOOLCHAIN_GOLANG
	default y
	help
	  Cgo enables the creation of Go packages that call C code.

	  http://golang.org/cmd/cgo/
```

## toolchain/golang_bootstrap/Config.in
```kconfig
config BR2_TOOLCHAIN_GOLANG_BOOTSTRAP
	bool "Build Go language (golang) bootstrap version."
	depends on BR2_arm || BR2_i386 || BR2_x86_64
	default n
	help
	  This is the Go language bootstrap version.

	  http://golang.org
```
