## configs/gftv100_defconfig
```kconfig
BR2_mipsel=y
BR2_mips_32=y
BR2_DL_DIR="${TOPDIR}/../vendor/opensource/tarballs"
BR2_CCACHE=y
BR2_ENABLE_DEBUG=y
BR2_OPTIMIZE_2=y
BR2_TOOLCHAIN_EXTERNAL=y
BR2_TOOLCHAIN_EXTERNAL_CUSTOM=y
BR2_TOOLCHAIN_EXTERNAL_PATH="${TOPDIR}/../toolchains/bruno"
BR2_TOOLCHAIN_EXTERNAL_CUSTOM_PREFIX="mipsel-linux"
BR2_TOOLCHAIN_EXTERNAL_LARGEFILE=y
BR2_TOOLCHAIN_EXTERNAL_INET_IPV6=y
BR2_TOOLCHAIN_EXTERNAL_INET_RPC=y
BR2_TOOLCHAIN_EXTERNAL_LOCALE=y
BR2_TOOLCHAIN_EXTERNAL_CXX=y
BR2_TOOLCHAIN_EXTRA_EXTERNAL_LIBS="libubacktrace.so libssp.so"
BR2_PACKAGE_GDB=y
BR2_GDB_VERSION_7_3=y
# BR2_SOFT_FLOAT is not set
BR2_ROOTFS_DEVICE_CREATION_DYNAMIC_DEVTMPFS=y
BR2_ROOTFS_DEVICE_TABLE="/dev/null"
BR2_ROOTFS_SKELETON_CUSTOM=y
BR2_ROOTFS_POST_BUILD_SCRIPT="${TOPDIR}/support/scripts/postbuild.sh"
BR2_TARGET_GENERIC_PLATFORM_NAME="gfibertv"
BR2_TARGET_GENERIC_PLATFORMS_SUPPORTED="GFMS100, GFHD100"
# BR2_PACKAGE_BUSYBOX is not set
BR2_PACKAGE_ALSA_LIB_PCM_PLUGINS="none"
BR2_PACKAGE_ALSA_LIB_CTL_PLUGINS="none"
# BR2_PACKAGE_ALSA_LIB_ALOAD is not set
# BR2_PACKAGE_ALSA_LIB_MIXER is not set
# BR2_PACKAGE_ALSA_LIB_RAWMIDI is not set
# BR2_PACKAGE_ALSA_LIB_HWDEP is not set
# BR2_PACKAGE_ALSA_LIB_SEQ is not set
# BR2_PACKAGE_ALSA_LIB_ALISP is not set
# BR2_PACKAGE_ALSA_LIB_OLD_SYMBOLS is not set
# BR2_PACKAGE_ALSA_UTILS_ALSACTL is not set
# BR2_PACKAGE_ALSA_UTILS_ALSAMIXER is not set
BR2_PACKAGE_GZIP=y
BR2_PACKAGE_PKG_CONFIG=y
BR2_PACKAGE_TAR=y
BR2_PACKAGE_DBUS_PYTHON=y
BR2_PACKAGE_DOSFSTOOLS=y
BR2_PACKAGE_DOSFSTOOLS_MKDOSFS=y
BR2_PACKAGE_DOSFSTOOLS_DOSFSCK=y
BR2_PACKAGE_E2FSPROGS=y
BR2_PACKAGE_HDPARM=y
BR2_PACKAGE_HWDATA=y
# BR2_PACKAGE_MTD_UBINIZE is not set
BR2_PACKAGE_SMARTMONTOOLS=y
BR2_PACKAGE_USB_MODESWITCH=y
BR2_PACKAGE_USBUTILS=y
BR2_PACKAGE_PYTHON=y
BR2_PACKAGE_PYTHON_BZIP2=y
BR2_PACKAGE_PYTHON_PYEXPAT=y
BR2_PACKAGE_PYTHON_READLINE=y
BR2_PACKAGE_PYTHON_SSL=y
BR2_PACKAGE_PYTHON_IPV6=y
BR2_PACKAGE_PY_GOOGLE_API=y
BR2_PACKAGE_PY_DNS=y
BR2_PACKAGE_PY_MONOTIME=y
BR2_PACKAGE_PYTHON_CRYPTO=y
BR2_PACKAGE_PYTHON_GOBJECT=y
BR2_PACKAGE_OPENSSL_BIN=y
# BR2_PACKAGE_AVAHI_AUTOIPD is not set
BR2_PACKAGE_BLUEZ_UTILS=y
BR2_PACKAGE_BRIDGE_UTILS=y
BR2_PACKAGE_DHCP=y
BR2_PACKAGE_DHCP_CLIENT=y
BR2_PACKAGE_EBTABLES=y
BR2_PACKAGE_IPROUTE2=y
BR2_PACKAGE_IPTABLES=y
BR2_PACKAGE_IPUTILS=y
# BR2_PACKAGE_SAMBA_EVENTLOGADM is not set
# BR2_PACKAGE_SAMBA_NET is not set
# BR2_PACKAGE_SAMBA_NMBLOOKUP is not set
# BR2_PACKAGE_SAMBA_NTLM_AUTH is not set
# BR2_PACKAGE_SAMBA_PDBEDIT is not set
# BR2_PACKAGE_SAMBA_PROFILES is not set
# BR2_PACKAGE_SAMBA_RPCCLIENT is not set
# BR2_PACKAGE_SAMBA_SMBCACLS is not set
# BR2_PACKAGE_SAMBA_SMBCLIENT is not set
# BR2_PACKAGE_SAMBA_SMBCONTROL is not set
# BR2_PACKAGE_SAMBA_SMBCQUOTAS is not set
# BR2_PACKAGE_SAMBA_SMBGET is not set
# BR2_PACKAGE_SAMBA_SMBLDBTOOLS is not set
# BR2_PACKAGE_SAMBA_SMBPASSWD is not set
# BR2_PACKAGE_SAMBA_SMBSHARESEC is not set
# BR2_PACKAGE_SAMBA_SMBSPOOL is not set
# BR2_PACKAGE_SAMBA_SMBSTATUS is not set
# BR2_PACKAGE_SAMBA_SMBTREE is not set
# BR2_PACKAGE_SAMBA_SWAT is not set
# BR2_PACKAGE_SAMBA_TDB is not set
# BR2_PACKAGE_SAMBA_TESTPARM is not set
# BR2_PACKAGE_SAMBA_WINBINDD is not set
# BR2_PACKAGE_SAMBA_AVAHI is not set
BR2_PACKAGE_VCONFIG=y
BR2_PACKAGE_ACL=y
BR2_PACKAGE_MODULE_INIT_TOOLS=y
BR2_PACKAGE_GPTFDISK=y
BR2_PACKAGE_GPTFDISK_GDISK=y
BR2_PACKAGE_GPTFDISK_SGDISK=y
BR2_PACKAGE_UTIL_LINUX_MOUNT=y
BR2_PACKAGE_UTIL_LINUX_SWITCH_ROOT=y
BR2_PACKAGE_UTIL_LINUX_PIVOT_ROOT=y
BR2_PACKAGE_GOOGLE_SKELMIR=y
#BR2_PACKAGE_BCM_MIRACAST=n
BR2_PACKAGE_GOOGLE_PLATFORM=y
BR2_PACKAGE_GOOGLE_PLATFORM_BASE=y
BR2_PACKAGE_GOOGLE_PLATFORM_HNVRAM=y
BR2_PACKAGE_GOOGLE_PULLREADER=y
BR2_PACKAGE_GOOGLE_TEST=y
BR2_PACKAGE_GOOGLE_STORAGE_BOX=y
BR2_PACKAGE_GOOGLE_TV_BOX=y
BR2_PACKAGE_CATAWAMPUS=y
BR2_PACKAGE_BCM_COMMON_PLATFORM="97425"
BR2_PACKAGE_BCM_COMMON_PLATFORM_REV="B2"
#BR2_PACKAGE_BCM_BLUETOOTH=n
#BR2_PACKAGE_BCM_BLUETOOTH_BSA=n
#BR2_PACKAGE_BCM_BLUETOOTH_FW=n
#BR2_PACKAGE_BCM_DRIVERS=n
#BR2_PACKAGE_BCM_DRIVER_MOCA=n
BR2_PACKAGE_BACKPORTS=n
BR2_PACKAGE_BACKPORTS_DEFCONFIG="gftv100_defconfig"
BR2_TARGET_ROOTFS_SQUASHFS=y
BR2_PACKAGE_SIMPLERAMFS=y
BR2_TARGET_ROOTFS_GINSTALL=y
BR2_TARGET_ROOTFS_GINSTALL_LOADER_DIR="../loader-bin/broadcom/cfe-bin/gftv100"
BR2_LINUX_KERNEL=y
BR2_LINUX_KERNEL_CUSTOM_GIT=y
BR2_LINUX_KERNEL_CUSTOM_GIT_REPO_URL="repo://kernel/bruno"
BR2_LINUX_KERNEL_CUSTOM_GIT_VERSION="HEAD"
BR2_LINUX_KERNEL_DEFCONFIG="bruno_gfhd100b2"
BR2_LINUX_KERNEL_VMLINUX=y
```

## configs/gftv100_toolchain_defconfig
```kconfig
BR2_mipsel=y
BR2_mips_32=y
BR2_DL_DIR="${TOPDIR}/../vendor/opensource/tarballs"
BR2_JLEVEL=15
BR2_CCACHE=y
BR2_ENABLE_DEBUG=y
BR2_OPTIMIZE_2=y
BR2_UCLIBC_CONFIG="toolchain/uClibc/bruno.config"
BR2_PACKAGE_GDB_HOST=y
BR2_GDB_VERSION_7_2=y
# BR2_SOFT_FLOAT is not set
BR2_TOOLCHAIN_BUILDROOT_LARGEFILE=y
BR2_TOOLCHAIN_BUILDROOT_INET_IPV6=y
BR2_TOOLCHAIN_BUILDROOT_INET_RPC=y
BR2_TOOLCHAIN_BUILDROOT_LOCALE=y
BR2_TOOLCHAIN_BUILDROOT_CXX=y
BR2_TOOLCHAIN_BUILDROOT_USE_SSP=y
BR2_ROOTFS_DEVICE_CREATION_DYNAMIC_DEVTMPFS=y
BR2_ROOTFS_DEVICE_TABLE="/dev/null"
BR2_ROOTFS_SKELETON_CUSTOM=y
BR2_TARGET_GENERIC_PLATFORM_NAME="gfibertv"
BR2_TARGET_GENERIC_PLATFORMS_SUPPORTED="GFMS100, GFHD100"
# BR2_PACKAGE_BUSYBOX is not set
# BR2_TARGET_ROOTFS_TAR is not set
```

## configs/gftv300_defconfig
```kconfig
BR2_arm=y
BR2_cortex_a9=y
BR2_DL_DIR="${TOPDIR}/../vendor/opensource/tarballs"
BR2_CCACHE=y
BR2_ENABLE_DEBUG=y
BR2_OPTIMIZE_2=y
BR2_TOOLCHAIN_EXTERNAL=y
BR2_TOOLCHAIN_EXTERNAL_CUSTOM=y
BR2_TOOLCHAIN_EXTERNAL_PATH="${TOPDIR}/../toolchains/bruno_arm"
BR2_TOOLCHAIN_EXTERNAL_CUSTOM_PREFIX="arm-linux"
BR2_TOOLCHAIN_EXTERNAL_CUSTOM_GLIBC=y
BR2_TOOLCHAIN_EXTERNAL_CXX=y
BR2_PACKAGE_GDB=y
BR2_GDB_VERSION_7_7=y
# BR2_SOFT_FLOAT is not set
BR2_ROOTFS_DEVICE_CREATION_DYNAMIC_DEVTMPFS=y
BR2_ROOTFS_DEVICE_TABLE="/dev/null"
BR2_ROOTFS_SKELETON_CUSTOM=y
BR2_ROOTFS_POST_BUILD_SCRIPT="${TOPDIR}/support/scripts/postbuild.sh"
BR2_TARGET_GENERIC_PLATFORM_NAME="gftv300"
BR2_TARGET_GENERIC_PLATFORMS_SUPPORTED="GFHD300"
# BR2_PACKAGE_BUSYBOX is not set
BR2_PACKAGE_GZIP=y
BR2_PACKAGE_PKG_CONFIG=y
BR2_PACKAGE_TAR=y
BR2_PACKAGE_DBUS_PYTHON=y
BR2_PACKAGE_DOSFSTOOLS=y
BR2_PACKAGE_DOSFSTOOLS_MKDOSFS=y
BR2_PACKAGE_DOSFSTOOLS_DOSFSCK=y
BR2_PACKAGE_E2FSPROGS=y
BR2_PACKAGE_HDPARM=y
BR2_PACKAGE_HWDATA=y
# BR2_PACKAGE_MTD_UBINIZE is not set
BR2_PACKAGE_USB_MODESWITCH=y
BR2_PACKAGE_USBUTILS=y
BR2_PACKAGE_PYTHON=y
BR2_PACKAGE_PYTHON_BZIP2=y
BR2_PACKAGE_PYTHON_PYEXPAT=y
BR2_PACKAGE_PYTHON_READLINE=y
BR2_PACKAGE_PYTHON_SSL=y
BR2_PACKAGE_PYTHON_IPV6=y
BR2_PACKAGE_PY_GOOGLE_API=y
BR2_PACKAGE_PY_DNS=y
BR2_PACKAGE_PY_MONOTIME=y
BR2_PACKAGE_PYTHON_CRYPTO=y
BR2_PACKAGE_PYTHON_GOBJECT=y
BR2_PACKAGE_OPENSSL_BIN=y
BR2_PACKAGE_BLUEZ_UTILS=y
BR2_PACKAGE_BRIDGE_UTILS=y
BR2_PACKAGE_DHCP=y
BR2_PACKAGE_DHCP_CLIENT=y
BR2_PACKAGE_EBTABLES=y
BR2_PACKAGE_HOSTAPD=y
BR2_PACKAGE_IPROUTE2=y
BR2_PACKAGE_IPTABLES=y
BR2_PACKAGE_IPUTILS=y
BR2_PACKAGE_IW=y
BR2_PACKAGE_VCONFIG=y
BR2_PACKAGE_WIRELESS_TOOLS=y
BR2_PACKAGE_WPA_SUPPLICANT=y
BR2_PACKAGE_WPA_SUPPLICANT_CLI=y
BR2_PACKAGE_WPA_SUPPLICANT_PASSPHRASE=y
BR2_PACKAGE_MODULE_INIT_TOOLS=y
BR2_PACKAGE_GPTFDISK=y
BR2_PACKAGE_GPTFDISK_GDISK=y
BR2_PACKAGE_GPTFDISK_SGDISK=y
BR2_PACKAGE_UTIL_LINUX_SWITCH_ROOT=y
BR2_PACKAGE_UTIL_LINUX_PIVOT_ROOT=y
BR2_PACKAGE_GOOGLE_SKELMIR=y
BR2_PACKAGE_GOOGLE_PLATFORM=y
BR2_PACKAGE_GOOGLE_PLATFORM_BASE=y
BR2_PACKAGE_GOOGLE_PLATFORM_HNVRAM=y
BR2_PACKAGE_GOOGLE_PLATFORM_LOGUPLOAD=y
BR2_PACKAGE_GOOGLE_PLATFORM_SYSMGR=y
BR2_PACKAGE_GOOGLE_TEST=y
BR2_PACKAGE_CATAWAMPUS=y
BR2_PACKAGE_BCM_COMMON_PLATFORM="97252"
BR2_PACKAGE_BCM_COMMON_PLATFORM_REV="B0"
BR2_TARGET_ROOTFS_SQUASHFS=y
BR2_PACKAGE_SIMPLERAMFS=y
BR2_TARGET_ROOTFS_GINSTALL=y
BR2_TARGET_ROOTFS_GINSTALL_V3=y
BR2_TARGET_ROOTFS_GINSTALL_LOADER_DIR="../loader-bin/broadcom/bolt-bin/gftv300"
BR2_LINUX_KERNEL=y
BR2_LINUX_KERNEL_CUSTOM_GIT=y
BR2_LINUX_KERNEL_CUSTOM_GIT_REPO_URL="repo://kernel/bruno_arm"
BR2_LINUX_KERNEL_CUSTOM_GIT_VERSION="HEAD"
BR2_LINUX_KERNEL_DEFCONFIG="bruno_gfhd300"
BR2_LINUX_KERNEL_ZIMAGE=y
BR2_PACKAGE_SIMPLERAMFS=y
```

## configs/gfwc100_defconfig
```kconfig
BR2_mips=y
BR2_mips_32r2=y

#BR2_MIPS_OABI32=y
#BR2_ARCH="mips"
#BR2_ENDIAN="BIG"
#BR2_GCC_TARGET_TUNE="mips32r2"
#BR2_GCC_TARGET_ABI="32"
#BR2_TARGET_OPTIMIZATION="-Os -pipe -funit-at-a-time -mips32r2 -mtune=mips32r2"
#BR2_CROSS_TOOLCHAIN_TARGET_UTILS=y

BR2_DL_DIR="${TOPDIR}/../vendor/opensource/tarballs"
BR2_JLEVEL=15
BR2_CCACHE=n
BR2_TOOLCHAIN_EXTERNAL=y
BR2_TOOLCHAIN_EXTERNAL_CUSTOM=y
BR2_TOOLCHAIN_EXTERNAL_PATH="${TOPDIR}/../toolchains/windcharger"
BR2_TOOLCHAIN_EXTERNAL_CUSTOM_PREFIX="mips-qca-linux-uclibc"
BR2_TOOLCHAIN_EXTERNAL_LARGEFILE=y
BR2_TOOLCHAIN_EXTERNAL_INET_IPV6=y
BR2_TOOLCHAIN_EXTERNAL_INET_RPC=y
BR2_TOOLCHAIN_EXTERNAL_WCHAR=y
BR2_TOOLCHAIN_EXTERNAL_CXX=y
BR2_TOOLCHAIN_HAS_THREADS_DEBUG=y
BR2_TARGET_GENERIC_HOSTNAME="gfwindcharger"
BR2_TARGET_GENERIC_ISSUE="Welcome to Google Fiber"
BR2_ROOTFS_DEVICE_CREATION_DYNAMIC_DEVTMPFS=y
BR2_ROOTFS_DEVICE_TABLE="/dev/null"
BR2_ROOTFS_SKELETON_CUSTOM=y
BR2_ROOTFS_POST_BUILD_SCRIPT="${TOPDIR}/support/scripts/postbuild.sh"
BR2_TARGET_GENERIC_PLATFORM_NAME="gfmn100"
BR2_TARGET_GENERIC_PLATFORMS_SUPPORTED="GFMN100"
# BR2_PACKAGE_BUSYBOX=y
BR2_PACKAGE_BUSYBOX=n
BR2_PACKAGE_TOOLBOX=y
BR2_PACKAGE_TOYBOX=y
BR2_PACKAGE_STRESS=n
BR2_PACKAGE_DEVMEM2=n
BR2_PACKAGE_MTD=y
BR2_PACKAGE_OPENSSL=y
BR2_PACKAGE_BRIDGE_UTILS=n
BR2_PACKAGE_QCA95XX=y
BR2_PACKAGE_PROCPS=y
BR2_LINUX_KERNEL_PATCH="${TOPDIR}/../kernel/windcharger/"
BR2_PACKAGE_LIBCURL=y
BR2_PACKAGE_DNSMASQ=y

BR2_PACKAGE_PYTHON=y
BR2_PACKAGE_PYTHON_PYEXPAT=y
BR2_PACKAGE_PYTHON_SSL=y
BR2_PACKAGE_PYTHON_IPV6=y
BR2_PACKAGE_PY_DNS=y
BR2_PACKAGE_PY_MONOTIME=y
BR2_PACKAGE_PYTHON_CRYPTO=y
BR2_PACKAGE_PYTHON_SETUPTOOLS=y
BR2_PACKAGE_CATAWAMPUS=y

BR2_PACKAGE_DHCP=y
BR2_PACKAGE_DHCP_CLIENT=y
BR2_PACKAGE_DROPBEAR=y
BR2_PACKAGE_IPROUTE2=y
BR2_PACKAGE_IPUTILS=y
BR2_PACKAGE_DASH=y
BR2_PACKAGE_NCURSES=y
BR2_PACKAGE_ZSH=y
BR2_PACKAGE_ZSH_BINARIES_ONLY=y
BR2_PACKAGE_SYSKLOGD=y
BR2_PACKAGE_UTIL_LINUX=y
BR2_PACKAGE_UTIL_LINUX_AGETTY=y
BR2_PACKAGE_UTIL_LINUX_LOGIN_UTILS=y
BR2_PACKAGE_NANO=n
BR2_PACKAGE_GOOGLE_PLATFORM=y
BR2_PACKAGE_GOOGLE_PLATFORM_BASE=y
BR2_PACKAGE_GOOGLE_WINDCHARGER=y

BR2_TARGET_ROOTFS_INITRAMFS=n
BR2_TARGET_ROOTFS_GINSTALL=y
BR2_TARGET_UBOOT=y
BR2_TARGET_UBOOT_BOARDNAME="gfwc100"
BR2_TARGET_UBOOT_CUSTOM_GIT=y
BR2_TARGET_UBOOT_CUSTOM_GIT_REPO_URL="repo://uboot/windcharger"
BR2_TARGET_UBOOT_CUSTOM_GIT_VERSION="HEAD"
BR2_LINUX_KERNEL=y
BR2_LINUX_KERNEL_CUSTOM_GIT=y
BR2_LINUX_KERNEL_CUSTOM_GIT_REPO_URL="repo://kernel/windcharger"
BR2_LINUX_KERNEL_CUSTOM_GIT_VERSION="HEAD"
BR2_LINUX_KERNEL_DEFCONFIG="gfwc100"
BR2_LINUX_KERNEL_ZIMAGE=y
```

## configs/kvm_toolchain_defconfig
```kconfig
BR2_DL_DIR="${TOPDIR}/../vendor/opensource/tarballs"
BR2_CCACHE=y
BR2_ENABLE_DEBUG=y
BR2_OPTIMIZE_2=y
BR2_UCLIBC_CONFIG="toolchain/uClibc/bruno.config"
BR2_BINUTILS_VERSION_2_21=y
BR2_PACKAGE_GDB_HOST=y
BR2_GDB_VERSION_7_2=y
BR2_TOOLCHAIN_BUILDROOT_LARGEFILE=y
BR2_TOOLCHAIN_BUILDROOT_INET_IPV6=y
BR2_TOOLCHAIN_BUILDROOT_INET_RPC=y
BR2_TOOLCHAIN_BUILDROOT_LOCALE=y
BR2_TOOLCHAIN_BUILDROOT_CXX=y
BR2_TOOLCHAIN_BUILDROOT_USE_SSP=y
BR2_ROOTFS_DEVICE_CREATION_DYNAMIC_DEVTMPFS=y
BR2_ROOTFS_DEVICE_TABLE="/dev/null"
BR2_ROOTFS_SKELETON_CUSTOM=y
# BR2_PACKAGE_BUSYBOX is not set
BR2_PACKAGE_NOPLATFORM=y
# BR2_TARGET_ROOTFS_TAR is not set
```

## configs/rd88f6601mc_defconfig
```kconfig
# Architecture
BR2_arm=y
BR2_arm926t=y
BR2_ARM_EABI=y
BR2_CCACHE=y
BR2_DL_DIR="${TOPDIR}/../vendor/opensource/tarballs"
BR2_GCC_TARGET_TUNE="marvell-f"
BR2_JLEVEL=15
BR2_LARGEFILE=y
BR2_USE_MMU=y
BR2_USE_WCHAR=y

# Toolchain
BR2_TOOLCHAIN_EXTERNAL=y
BR2_TOOLCHAIN_EXTERNAL_CUSTOM=y
BR2_TOOLCHAIN_EXTERNAL_PATH="${TOPDIR}/../toolchains/prism"
BR2_TOOLCHAIN_EXTERNAL_CUSTOM_PREFIX="arm-marvell-linux-uclibcgnueabi"
BR2_TOOLCHAIN_EXTERNAL_UCLIBC=y
BR2_TOOLCHAIN_EXTERNAL_CUSTOM_UCLIBC=y
BR2_TOOLCHAIN_EXTERNAL_CXX=y
BR2_TOOLCHAIN_EXTERNAL_INET_IPV6=y
BR2_TOOLCHAIN_EXTERNAL_INET_RPC=y
BR2_TOOLCHAIN_EXTERNAL_LARGEFILE=y
BR2_TOOLCHAIN_EXTERNAL_WCHAR=y

# U-Boot
BR2_TARGET_UBOOT=y
BR2_TARGET_UBOOT_CUSTOM_GIT=y
BR2_TARGET_UBOOT_CUSTOM_GIT_REPO_URL="repo://uboot/prism"
BR2_TARGET_UBOOT_CUSTOM_GIT_VERSION="HEAD"
BR2_TARGET_UBOOT_VERSION="HEAD"
BR2_TARGET_UBOOT_PATCH=""
BR2_TARGET_UBOOT_CUSTOM_VERSION=y
BR2_TARGET_UBOOT_CUSTOM_VERSION_VALUE="2009.08mv"
BR2_TARGET_UBOOT_DEFCONFIG="rd88f6601mc"
BR2_TARGET_UBOOT_BOARDNAME="rd88f6601mc"

# Kernel
BR2_LINUX_KERNEL=y
BR2_LINUX_KERNEL_CUSTOM_GIT=y
BR2_LINUX_KERNEL_CUSTOM_GIT_REPO_URL="repo://kernel/prism"
BR2_LINUX_KERNEL_CUSTOM_GIT_VERSION="HEAD"
BR2_LINUX_KERNEL_VERSION="HEAD"
BR2_LINUX_KERNEL_PATCH=""
BR2_LINUX_KERNEL_USE_DEFCONFIG=y
BR2_LINUX_KERNEL_DEFCONFIG="mv88f6601"
BR2_LINUX_KERNEL_UIMAGE=y
BR2_LINUX_KERNEL_INSTALL_TARGET=y

# Packages
BR2_PACKAGE_BUSYBOX=n
BR2_PACKAGE_CURL=y
BR2_PACKAGE_DASH=y
BR2_PACKAGE_DEVMEM2=y
BR2_PACKAGE_DHCP=y
BR2_PACKAGE_DHCP_CLIENT=y
BR2_PACKAGE_DROPBEAR=y
BR2_PACKAGE_EXPAT=y
BR2_PACKAGE_IPROUTE2=y
BR2_PACKAGE_IPUTILS=y
BR2_PACKAGE_LIBCURL=y
BR2_PACKAGE_LIBLOCKFILE=y
BR2_PACKAGE_LOCKFILE_PROGS=y
BR2_PACKAGE_MV_APP=y
BR2_PACKAGE_NANO=y
BR2_PACKAGE_OPENNTPD=y
BR2_PACKAGE_PRISM=y
BR2_PACKAGE_PROCPS=y
BR2_PACKAGE_SQLITE=y
BR2_PACKAGE_SYSKLOGD=y
BR2_PACKAGE_SYSVINIT=y
BR2_PACKAGE_TOOLBOX=y
BR2_PACKAGE_TOYBOX=y
BR2_PACKAGE_TOYBOX_CONFIG="package/toybox/toybox.config"
BR2_PACKAGE_UTIL_LINUX=y
BR2_PACKAGE_UTIL_LINUX_AGETTY=y
BR2_PACKAGE_UTIL_LINUX_LOGIN_UTILS=y
BR2_PACKAGE_ZLIB=y
BR2_PACKAGE_ZSH=y
BR2_PACKAGE_ZSH_BINARIES_ONLY=y

# Filesystem
BR2_ROOTFS_DEVICE_CREATION_DYNAMIC_DEVTMPFS=y
BR2_ROOTFS_DEVICE_TABLE="/dev/null"
BR2_ROOTFS_POST_BUILD_SCRIPT="${TOPDIR}/support/scripts/postbuild.sh"
BR2_ROOTFS_SKELETON_CUSTOM=y
BR2_ROOTFS_SKELETON_CUSTOM_PATH="fs/skeleton"
BR2_TARGET_GENERIC_HOSTNAME="gfiberjack"
BR2_TARGET_GENERIC_ISSUE="Welcome to Google Fiber"
BR2_TARGET_ROOTFS_INITRAMFS=y

# HAL related packages
BR2_PACKAGE_I2C_TOOLS=y
BR2_PACKAGE_LIBYAML=y
BR2_PACKAGE_PY_YAML=y

# TR-069 related packages
BR2_PACKAGE_PYTHON=y
BR2_PACKAGE_PYTHON_PYC_ONLY=y
BR2_PACKAGE_PYTHON_PYEXPAT=y
BR2_PACKAGE_PYTHON_SSL=y
BR2_PACKAGE_PYTHON_IPV6=y
BR2_PACKAGE_PYTHON_ZLIB=y
BR2_PACKAGE_CATAWAMPUS=y
```

## configs/uno_defconfig
```kconfig
BR2_arm=y
BR2_TOOLCHAIN_EXTERNAL=y
BR2_TOOLCHAIN_EXTERNAL_CUSTOM=y
BR2_TOOLCHAIN_EXTERNAL_PATH="${TOPDIR}/../toolchains/uno"
BR2_TOOLCHAIN_EXTERNAL_CUSTOM_PREFIX="arm-mv5sft-linux-gnueabi"
BR2_TOOLCHAIN_EXTERNAL_CUSTOM_GLIBC=y
BR2_TOOLCHAIN_EXTERNAL_CXX=y
BR2_LINUX_KERNEL=y
BR2_LINUX_KERNEL_CUSTOM_GIT=y
BR2_LINUX_KERNEL_CUSTOM_GIT_REPO_URL="git://localhost/kernel-uno.git"
BR2_LINUX_KERNEL_CUSTOM_GIT_VERSION="master"
BR2_LINUX_KERNEL_DEFCONFIG="mv88f6500_gw"
BR2_LINUX_KERNEL_INSTALL_TARGET=y
```

## fs/ginstall/Config.in
```kconfig
config BR2_TARGET_ROOTFS_GINSTALL
	bool "ginstall"
	select BR2_PACKAGE_HOST_UBOOT_TOOLS if BR2_LINUX_KERNEL_ZIMAGE
	help
	  Create installer package for Google platforms

if BR2_TARGET_ROOTFS_GINSTALL
choice
	prompt "Image version"
	default BR2_TARGET_ROOTFS_GINSTALL_V2
	help
	  Select the image version to build.

config BR2_TARGET_ROOTFS_GINSTALL_V2
	bool "v2"

config BR2_TARGET_ROOTFS_GINSTALL_V3
	bool "v3"

config BR2_TARGET_ROOTFS_GINSTALL_V4
	bool "v4"

endchoice

config BR2_TARGET_ROOTFS_GINSTALL_LOADER_DIR
	string "Directory to obtain bootloader from"
	depends on BR2_TARGET_ROOTFS_GINSTALL
	help
	  Path from buildroot of where to find bootloaders
	  for this platform.

endif
```

## fs/recoveryfs/Config.in
```kconfig
config BR2_TARGET_ROOTFS_RECOVERYFS
       bool "Recovery Image"
       depends on BR2_PACKAGE_SIMPLERAMFS
       depends on BR2_TARGET_ROOTFS_SQUASHFS
       depends on !BR2_PACKAGE_GOOGLE_PROD
       help
	 Build recovery image.
```
