## boot/barebox_uloader/Config.in
```kconfig
config BR2_TARGET_BAREBOX_ULOADER
	bool "Barebox uloader"
	help
	  First-stage bootloader based on barebox.

	  http://www.barebox.org

if BR2_TARGET_BAREBOX_ULOADER

config BR2_TARGET_BAREBOX_ULOADER_URL
	string "URL of custom Git repository"

config BR2_TARGET_BAREBOX_ULOADER_BOARD_DEFCONFIG
	string "board defconfig"
	help
	  Name of the board for which uloader should be built, without
	  the _defconfig suffix.

endif
```

## configs/bcm7425_test_defconfig
```kconfig
BR2_mips=y
BR2_CCACHE=y
BR2_TOOLCHAIN_EXTERNAL=y
BR2_TOOLCHAIN_EXTERNAL_CUSTOM=y
BR2_TOOLCHAIN_EXTERNAL_PATH="${TOPDIR}/../toolchains/bruno"
BR2_TOOLCHAIN_EXTERNAL_CUSTOM_PREFIX="mipsel-linux"
BR2_TOOLCHAIN_EXTERNAL_LARGEFILE=y
BR2_TOOLCHAIN_EXTERNAL_INET_IPV6=y
BR2_TOOLCHAIN_EXTERNAL_INET_RPC=y
BR2_TOOLCHAIN_EXTERNAL_LOCALE=y
BR2_TOOLCHAIN_EXTERNAL_CXX=y
# BR2_SOFT_FLOAT is not set
BR2_PACKAGE_DROPBEAR=y
BR2_PACKAGE_IPERF=y
# BR2_PACKAGE_BRUNO is not set
BR2_PACKAGE_GOOGLE_MINICLIENT=y
BR2_PACKAGE_GOOGLE_PULLREADER=y
BR2_PACKAGE_GOOGLE_FFMPEG=y
BR2_PACKAGE_BCM_BSEAV=y
BR2_PACKAGE_BCM_NEXUS=y
BR2_PACKAGE_BCM_APPS=y
BR2_PACKAGE_BCM_APP_REFSW=y
BR2_PACKAGE_BCM_APP_DLNA=y
BR2_PACKAGE_BCM_APP_STAGECRAFT=y
BR2_PACKAGE_BCM_APP_ARGO=y
BR2_PACKAGE_BCM_APP_COVERFLOW3D=y
BR2_PACKAGE_BCM_APP_BROWSER=y
BR2_PACKAGE_BCM_APP_ALSA=y
BR2_PACKAGE_BCM_APP_QT=y
BR2_PACKAGE_BCM_APP_LIBCURL=y
BR2_PACKAGE_BCM_APP_SQLITE=y
BR2_PACKAGE_BCM_APP_LIBXML2=y
BR2_PACKAGE_BCM_APP_ZLIB=y
BR2_PACKAGE_BCM_APP_LIBPNG=y
BR2_PACKAGE_BCM_APP_JPEG=y
BR2_TARGET_ROOTFS_JFFS2=y
BR2_TARGET_ROOTFS_JFFS2_CUSTOM=y
BR2_TARGET_ROOTFS_JFFS2_NOCLEANMARKER=y
BR2_TARGET_ROOTFS_JFFS2_LE=y
BR2_TARGET_ROOTFS_UBIFS=y
BR2_LINUX_KERNEL=y
BR2_LINUX_KERNEL_CUSTOM_GIT=y
BR2_LINUX_KERNEL_CUSTOM_GIT_REPO_URL="repo://kernel/bruno"
BR2_LINUX_KERNEL_CUSTOM_GIT_VERSION="HEAD"
BR2_LINUX_KERNEL_DEFCONFIG="bcm7425a0"
BR2_LINUX_KERNEL_INSTALL_TARGET=y
```

## configs/bruno_defconfig
```kconfig
BR2_mips=y
BR2_CCACHE=y
BR2_TOOLCHAIN_EXTERNAL=y
BR2_TOOLCHAIN_EXTERNAL_CUSTOM=y
BR2_TOOLCHAIN_EXTERNAL_PATH="${TOPDIR}/../toolchains/bruno"
BR2_TOOLCHAIN_EXTERNAL_CUSTOM_PREFIX="mipsel-linux"
BR2_TOOLCHAIN_EXTERNAL_LARGEFILE=y
BR2_TOOLCHAIN_EXTERNAL_INET_IPV6=y
BR2_TOOLCHAIN_EXTERNAL_INET_RPC=y
BR2_TOOLCHAIN_EXTERNAL_LOCALE=y
BR2_TOOLCHAIN_EXTERNAL_CXX=y
BR2_SOFT_FLOAT=n
BR2_PACKAGE_BCM_BSEAV=y
BR2_PACKAGE_BCM_NEXUS=y
BR2_TARGET_ROOTFS_JFFS2=y
BR2_TARGET_ROOTFS_JFFS2_CUSTOM=y
BR2_TARGET_ROOTFS_JFFS2_CUSTOM_PAGESIZE=0x1000
BR2_TARGET_ROOTFS_JFFS2_EBSIZE=0x20000
BR2_TARGET_ROOTFS_JFFS2_NOCLEANMARKER=y
BR2_TARGET_ROOTFS_JFFS2_LE=y
BR2_TARGET_ROOTFS_UBIFS=y
BR2_LINUX_KERNEL=y
BR2_LINUX_KERNEL_CUSTOM_GIT=y
BR2_LINUX_KERNEL_CUSTOM_GIT_REPO_URL="repo://kernel/bruno"
BR2_LINUX_KERNEL_CUSTOM_GIT_VERSION="HEAD"
BR2_LINUX_KERNEL_DEFCONFIG="bcm7425a0"
BR2_LINUX_KERNEL_INSTALL_TARGET=y
```

## configs/bruno_gfhd100_defconfig
```kconfig
BR2_mips=y
BR2_DL_DIR="${TOPDIR}/../vendor/opensource/tarballs"
BR2_JLEVEL=6
BR2_CCACHE=y
BR2_TOOLCHAIN_EXTERNAL=y
BR2_TOOLCHAIN_EXTERNAL_CUSTOM=y
BR2_TOOLCHAIN_EXTERNAL_PATH="${TOPDIR}/../toolchains/bruno"
BR2_TOOLCHAIN_EXTERNAL_CUSTOM_PREFIX="mipsel-linux"
BR2_TOOLCHAIN_EXTERNAL_LARGEFILE=y
BR2_TOOLCHAIN_EXTERNAL_INET_IPV6=y
BR2_TOOLCHAIN_EXTERNAL_INET_RPC=y
BR2_TOOLCHAIN_EXTERNAL_LOCALE=y
BR2_TOOLCHAIN_EXTERNAL_CXX=y
BR2_SOFT_FLOAT=n
BR2_PACKAGE_BCM_BSEAV=y
BR2_PACKAGE_BCM_NEXUS=y
BR2_PACKAGE_BCM_APPS=y
BR2_PACKAGE_BCM_APP_DIRECTFB=y
BR2_PACKAGE_ALSA_UTILS=y
BR2_PACKAGE_PKG_CONFIG=y
BR2_PACKAGE_BCM_ALSA=y
BR2_PACKAGE_LIBPNG=y
BR2_PACKAGE_ZLIB=y
BR2_PACKAGE_JPEG=y
BR2_PACKAGE_PYTHON=y
BR2_PACKAGE_PYTHON_ZLIB=y
BR2_PACKAGE_PYTHON_PYEXPAT=y
BR2_PACKAGE_PYTHON_SSL=y
BR2_PACKAGE_PY_GOOGLE_API=y
BR2_TARGET_ROOTFS_JFFS2=y
BR2_TARGET_ROOTFS_JFFS2_CUSTOM=y
BR2_TARGET_ROOTFS_JFFS2_CUSTOM_PAGESIZE=0x1000
BR2_TARGET_ROOTFS_JFFS2_EBSIZE=0x20000
BR2_TARGET_ROOTFS_JFFS2_NOCLEANMARKER=y
BR2_TARGET_ROOTFS_JFFS2_LE=y
BR2_TARGET_ROOTFS_UBIFS=y
BR2_LINUX_KERNEL=y
BR2_LINUX_KERNEL_CUSTOM_GIT=y
BR2_LINUX_KERNEL_CUSTOM_GIT_REPO_URL="repo://kernel/bruno"
BR2_LINUX_KERNEL_CUSTOM_GIT_VERSION="HEAD"
BR2_LINUX_KERNEL_DEFCONFIG="bruno_gfhd100"
BR2_LINUX_KERNEL_INSTALL_TARGET=y
```

## configs/bruno_gfhd100_test_defconfig
```kconfig
BR2_mips=y
BR2_DL_DIR="${TOPDIR}/../vendor/opensource/tarballs"
BR2_JLEVEL=6
BR2_CCACHE=y
BR2_STRIP_none=y
BR2_TOOLCHAIN_EXTERNAL=y
BR2_TOOLCHAIN_EXTERNAL_CUSTOM=y
BR2_TOOLCHAIN_EXTERNAL_PATH="${TOPDIR}/../toolchains/bruno"
BR2_TOOLCHAIN_EXTERNAL_CUSTOM_PREFIX="mipsel-linux"
BR2_TOOLCHAIN_EXTERNAL_LARGEFILE=y
BR2_TOOLCHAIN_EXTERNAL_INET_IPV6=y
BR2_TOOLCHAIN_EXTERNAL_INET_RPC=y
BR2_TOOLCHAIN_EXTERNAL_LOCALE=y
BR2_TOOLCHAIN_EXTERNAL_CXX=y
# BR2_SOFT_FLOAT is not set
BR2_PACKAGE_ALSA_UTILS=y
BR2_PACKAGE_PKG_CONFIG=y
BR2_PACKAGE_JPEG=y
BR2_PACKAGE_LIBPNG=y
BR2_PACKAGE_DROPBEAR=y
BR2_PACKAGE_ETHTOOL=y
BR2_PACKAGE_IPERF=y
BR2_PACKAGE_NTP=y
BR2_PACKAGE_TCPDUMP=y
BR2_PACKAGE_TCPDUMP_SMB=y
BR2_PACKAGE_SAGETV_MINICLIENT=y
BR2_PACKAGE_SAGETV_PULLREADER=y
BR2_PACKAGE_SAGETV_FFMPEG=y
BR2_PACKAGE_BCM_APPS=y
BR2_PACKAGE_BCM_APP_DIRECTFB=y
BR2_PACKAGE_BCM_ALSA=y
BR2_PACKAGE_BCM_DRIVER_BLUETOOTH=y
BR2_PACKAGE_BCM_DRIVER_MOCA=y
BR2_PACKAGE_BCM_DRIVER_WIFI=y
BR2_TARGET_ROOTFS_JFFS2=y
BR2_TARGET_ROOTFS_JFFS2_CUSTOM=y
BR2_TARGET_ROOTFS_JFFS2_NOCLEANMARKER=y
BR2_TARGET_ROOTFS_JFFS2_LE=y
BR2_TARGET_ROOTFS_UBIFS=y
BR2_TARGET_ROOTFS_SQUASHFS=y
BR2_LINUX_KERNEL=y
BR2_LINUX_KERNEL_CUSTOM_GIT=y
BR2_LINUX_KERNEL_CUSTOM_GIT_REPO_URL="repo://kernel/bruno"
BR2_LINUX_KERNEL_CUSTOM_GIT_VERSION="HEAD"
BR2_LINUX_KERNEL_DEFCONFIG="bruno_gfhd100"
BR2_LINUX_KERNEL_VMLINUX=y
```

## configs/bruno_gfhd100b2_defconfig
```kconfig
BR2_mipsel=y
BR2_mips_32=y
BR2_DL_DIR="${TOPDIR}/../vendor/opensource/tarballs"
BR2_JLEVEL=15
BR2_CCACHE=y
BR2_OPTIMIZE_2=y
BR2_TOOLCHAIN_EXTERNAL=y
BR2_TOOLCHAIN_EXTERNAL_CUSTOM=y
BR2_TOOLCHAIN_EXTERNAL_PATH="${TOPDIR}/../toolchains/bruno"
BR2_TOOLCHAIN_EXTERNAL_CUSTOM_PREFIX="mipsel-linux"
BR2_TOOLCHAIN_EXTERNAL_LARGEFILE=y
BR2_TOOLCHAIN_EXTERNAL_INET_IPV6=y
BR2_TOOLCHAIN_EXTERNAL_INET_RPC=y
BR2_TOOLCHAIN_EXTERNAL_LOCALE=y
BR2_TOOLCHAIN_EXTERNAL_CXX=y
BR2_TOOLCHAIN_EXTRA_EXTERNAL_LIBS="libubacktrace.so libssp.so"
BR2_PACKAGE_GDB=y
BR2_GDB_VERSION_7_3=y
# BR2_SOFT_FLOAT is not set
BR2_ROOTFS_DEVICE_CREATION_DYNAMIC_DEVTMPFS=y
BR2_ROOTFS_DEVICE_TABLE="/dev/null"
BR2_ROOTFS_SKELETON_CUSTOM=y
BR2_ROOTFS_SKELETON_CUSTOM_PATH="package/bruno/skel"
BR2_ROOTFS_POST_BUILD_SCRIPT="${TOPDIR}/package/bruno/copy_skel.sh"
# BR2_PACKAGE_BUSYBOX is not set
BR2_PACKAGE_ALSA_UTILS=y
BR2_PACKAGE_GZIP=y
BR2_PACKAGE_NMAP=y
BR2_PACKAGE_PKG_CONFIG=y
BR2_PACKAGE_TAR=y
BR2_PACKAGE_E2FSPROGS=y
BR2_PACKAGE_HDPARM=y
BR2_PACKAGE_HWDATA=y
# BR2_PACKAGE_MTD_UBINIZE is not set
BR2_PACKAGE_SMARTMONTOOLS=y
BR2_PACKAGE_USB_MODESWITCH=y
BR2_PACKAGE_USBUTILS=y
BR2_PACKAGE_PYTHON=y
BR2_PACKAGE_PYTHON_PYEXPAT=y
BR2_PACKAGE_PYTHON_SSL=y
BR2_PACKAGE_PYTHON_ZLIB=y
BR2_PACKAGE_PYTHON_IPV6=y
BR2_PACKAGE_PY_GOOGLE_API=y
BR2_PACKAGE_PY_MONOTIME=y
BR2_PACKAGE_PYTHON_CRYPTO=y
BR2_PACKAGE_FONTCONFIG=y
BR2_PACKAGE_LIBPNG=y
BR2_PACKAGE_LIBUNGIF=y
BR2_PACKAGE_PIXMAN=y
BR2_PACKAGE_TIFF=y
BR2_PACKAGE_LIBCURL=y
BR2_PACKAGE_CURL=y
BR2_PACKAGE_AVAHI=y
# BR2_PACKAGE_AVAHI_AUTOIPD is not set
BR2_PACKAGE_AVAHI_DAEMON=y
BR2_PACKAGE_BRIDGE_UTILS=y
BR2_PACKAGE_DHCP=y
BR2_PACKAGE_DHCP_CLIENT=y
BR2_PACKAGE_DROPBEAR_DISABLE_REVERSEDNS=y
BR2_PACKAGE_EBTABLES=y
BR2_PACKAGE_IPROUTE2=y
BR2_PACKAGE_IPTABLES=y
BR2_PACKAGE_IPUTILS=y
BR2_PACKAGE_OPENNTPD=y
BR2_PACKAGE_SAMBA=y
# BR2_PACKAGE_SAMBA_EVENTLOGADM is not set
# BR2_PACKAGE_SAMBA_NET is not set
# BR2_PACKAGE_SAMBA_NMBLOOKUP is not set
# BR2_PACKAGE_SAMBA_NTLM_AUTH is not set
# BR2_PACKAGE_SAMBA_PDBEDIT is not set
# BR2_PACKAGE_SAMBA_PROFILES is not set
# BR2_PACKAGE_SAMBA_RPCCLIENT is not set
# BR2_PACKAGE_SAMBA_SMBCACLS is not set
# BR2_PACKAGE_SAMBA_SMBCLIENT is not set
# BR2_PACKAGE_SAMBA_SMBCONTROL is not set
# BR2_PACKAGE_SAMBA_SMBCQUOTAS is not set
# BR2_PACKAGE_SAMBA_SMBGET is not set
# BR2_PACKAGE_SAMBA_SMBLDBTOOLS is not set
# BR2_PACKAGE_SAMBA_SMBPASSWD is not set
# BR2_PACKAGE_SAMBA_SMBSHARESEC is not set
# BR2_PACKAGE_SAMBA_SMBSPOOL is not set
# BR2_PACKAGE_SAMBA_SMBSTATUS is not set
# BR2_PACKAGE_SAMBA_SMBTREE is not set
# BR2_PACKAGE_SAMBA_SWAT is not set
# BR2_PACKAGE_SAMBA_TDB is not set
# BR2_PACKAGE_SAMBA_TESTPARM is not set
# BR2_PACKAGE_SAMBA_WINBINDD is not set
# BR2_PACKAGE_SAMBA_AVAHI is not set
BR2_PACKAGE_VCONFIG=y
BR2_PACKAGE_ZSH=y
BR2_PACKAGE_LOCKFILE_PROGS=y
BR2_PACKAGE_ACL=y
BR2_PACKAGE_MODULE_INIT_TOOLS=y
BR2_PACKAGE_PROCPS=y
BR2_PACKAGE_SYSKLOGD=y
BR2_PACKAGE_SYSVINIT=y
BR2_PACKAGE_UTIL_LINUX_SWITCH_ROOT=y
BR2_PACKAGE_UTIL_LINUX_PIVOT_ROOT=y
BR2_PACKAGE_LESS=y
BR2_PACKAGE_NANO=y
BR2_PACKAGE_BRUNO_TEST=y
BR2_PACKAGE_BRUNO_DEBUG=y
BR2_PACKAGE_GOOGLE_HNVRAM=y
BR2_PACKAGE_CATAWAMPUS=y
BR2_TARGET_ROOTFS_SQUASHFS=y
BR2_PACKAGE_SIMPLERAMFS=y
BR2_TARGET_ROOTFS_GINSTALL=y
BR2_LINUX_KERNEL=y
BR2_LINUX_KERNEL_CUSTOM_GIT=y
BR2_LINUX_KERNEL_CUSTOM_GIT_REPO_URL="repo://kernel/bruno"
BR2_LINUX_KERNEL_CUSTOM_GIT_VERSION="HEAD"
BR2_LINUX_KERNEL_DEFCONFIG="bruno_gfhd100b2"
BR2_LINUX_KERNEL_VMLINUX=y
```

## configs/fds_defconfig
```kconfig
BR2_x86_64=y
BR2_DL_DIR="${TOPDIR}/../vendor/opensource/tarballs"
BR2_JLEVEL=48
BR2_CCACHE=y
BR2_OPTIMIZE_2=y
BR2_TOOLCHAIN_EXTERNAL=y
BR2_TOOLCHAIN_EXTERNAL_CUSTOM=y
BR2_TOOLCHAIN_EXTERNAL_PATH="${TOPDIR}/../toolchains/kvm"
BR2_TOOLCHAIN_EXTERNAL_CUSTOM_PREFIX="x86_64-buildroot-linux-gnu"
BR2_TOOLCHAIN_EXTERNAL_CUSTOM_GLIBC=y
BR2_TOOLCHAIN_EXTERNAL_CXX=y
BR2_ENABLE_LOCALE_PURGE=y
BR2_PACKAGE_GOOGLE_SPACECAST=y
BR2_PACKAGE_GOOGLE_SPACECAST_TARGET="spacecast_FDS.mk"
# BR2_PACKAGE_BUSYBOX is not set
# BR2_TARGET_ROOTFS_TAR is not set
BR2_TARGET_GENERIC_PLATFORM_NAME="gfsc_none"
```

## configs/gfch100_defconfig
```kconfig
BR2_arm=y
BR2_cortex_a9=y
BR2_GCC_TARGET_TUNE=""
BR2_DL_DIR="${TOPDIR}/../vendor/opensource/tarballs"
BR2_JLEVEL=15
BR2_CCACHE=y
BR2_ENABLE_DEBUG=y
BR2_OPTIMIZE_2=y
BR2_TOOLCHAIN_EXTERNAL=y
BR2_TOOLCHAIN_EXTERNAL_CUSTOM=y
BR2_TOOLCHAIN_EXTERNAL_PATH="${TOPDIR}/../toolchains/armada"
BR2_TOOLCHAIN_EXTERNAL_CUSTOM_PREFIX="arm-marvell-linux-uclibcgnueabi"
BR2_TOOLCHAIN_EXTERNAL_LARGEFILE=y
BR2_TOOLCHAIN_EXTERNAL_INET_IPV6=y
BR2_TOOLCHAIN_EXTERNAL_INET_RPC=y
BR2_TOOLCHAIN_EXTERNAL_WCHAR=y
BR2_TOOLCHAIN_EXTERNAL_CXX=y
BR2_PACKAGE_GDB=y
BR2_GDB_VERSION_7_7=y
BR2_TARGET_OPTIMIZATION="-pipe -Wl,-z,relro,-z,now,-z,noexecstack"
BR2_TARGET_LDFLAGS="-Wl,-z,relro,-z,now,-z,noexecstack"
BR2_ROOTFS_DEVICE_CREATION_DYNAMIC_DEVTMPFS=y
BR2_ROOTFS_DEVICE_TABLE="/dev/null"
BR2_ROOTFS_SKELETON_CUSTOM=y
BR2_ROOTFS_POST_BUILD_SCRIPT="${TOPDIR}/support/scripts/postbuild.sh"
BR2_TARGET_GENERIC_PLATFORM_NAME="gfch100"
BR2_TARGET_GENERIC_PLATFORMS_SUPPORTED="GFCH100 GFCH110"
# BR2_PACKAGE_BUSYBOX is not set
BR2_PACKAGE_GZIP=y
BR2_PACKAGE_TRACE_CMD=y
BR2_PACKAGE_PKG_CONFIG=y
BR2_PACKAGE_TAR=y
BR2_PACKAGE_E2FSPROGS=y
BR2_PACKAGE_HWDATA=y
BR2_PACKAGE_I2C_TOOLS=y
# BR2_PACKAGE_MTD_UBINIZE is not set
BR2_PACKAGE_SMARTMONTOOLS=y
BR2_PACKAGE_USB_MODESWITCH=y
BR2_PACKAGE_USBUTILS=y
BR2_PACKAGE_PYTHON=y
BR2_PACKAGE_PYTHON_BZIP2=y
BR2_PACKAGE_PYTHON_READLINE=y
BR2_PACKAGE_PYTHON_SSL=y
BR2_PACKAGE_PYTHON_PYEXPAT=y
BR2_PACKAGE_PY_GOOGLE_API=y
BR2_PACKAGE_PY_DNS=y
BR2_PACKAGE_PY_MONOTIME=y
BR2_PACKAGE_PYTHON_CRYPTO=y
BR2_PACKAGE_OPENSSL_BIN=y
BR2_PACKAGE_LIBCLI=y
BR2_PACKAGE_BRIDGE_UTILS=y
BR2_PACKAGE_DHCP=y
BR2_PACKAGE_DHCP_CLIENT=y
BR2_PACKAGE_EBTABLES=y
BR2_PACKAGE_IPROUTE2=y
BR2_PACKAGE_IPTABLES=y
BR2_PACKAGE_IPUTILS=y
BR2_PACKAGE_NDISC6=y
BR2_PACKAGE_NDISC6_NDISC6=y
BR2_PACKAGE_NDISC6_RDISC6=y
BR2_PACKAGE_VCONFIG=y
BR2_PACKAGE_MODULE_INIT_TOOLS=y
BR2_PACKAGE_UTIL_LINUX_SWITCH_ROOT=y
BR2_PACKAGE_GOOGLE_PLATFORM=y
BR2_PACKAGE_GOOGLE_PLATFORM_BASE=y
BR2_PACKAGE_GOOGLE_PLATFORM_HNVRAM=y
BR2_PACKAGE_GOOGLE_PLATFORM_LOGUPLOAD=y
BR2_PACKAGE_GOOGLE_PLATFORM_SYSMGR=y
BR2_PACKAGE_GOOGLE_TEST=y
BR2_PACKAGE_GOOGLE_PLATFORM_ONLY=y
BR2_PACKAGE_CATAWAMPUS=y
BR2_PACKAGE_FIRMWARE=y
BR2_TARGET_ROOTFS_SQUASHFS=y
BR2_TARGET_ROOTFS_SQUASHFS4_XZ=y
# BR2_TARGET_ROOTFS_TAR is not set
BR2_PACKAGE_SIMPLERAMFS=y
# BR2_PACKAGE_SIMPLERAMFS_LINKED_IN is not set
BR2_TARGET_ROOTFS_GINSTALL=y
BR2_TARGET_ROOTFS_GINSTALL_V4=y
BR2_TARGET_ROOTFS_GINSTALL_LOADER_DIR="../loader-bin/marvell/gfch100"
BR2_LINUX_KERNEL=y
BR2_LINUX_KERNEL_CUSTOM_GIT=y
BR2_LINUX_KERNEL_CUSTOM_GIT_REPO_URL="repo://kernel/bruno"
BR2_LINUX_KERNEL_CUSTOM_GIT_VERSION="HEAD"
BR2_LINUX_KERNEL_DEFCONFIG="gfch100"
BR2_LINUX_KERNEL_ZIMAGE=y
BR2_LINUX_KERNEL_DTS_SUPPORT=y
BR2_LINUX_KERNEL_INTREE_DTS_NAME="gfch100"
```

## configs/gfex250_defconfig
```kconfig
BR2_arc=y
BR2_DL_DIR="${TOPDIR}/../vendor/opensource/tarballs"
BR2_JLEVEL=15
BR2_CCACHE=y
BR2_TOOLCHAIN_EXTERNAL=y
BR2_TOOLCHAIN_EXTERNAL_PATH="${TOPDIR}/../toolchains/skids"
BR2_TOOLCHAIN_EXTERNAL_CUSTOM_PREFIX="arc-linux-uclibc"
BR2_TOOLCHAIN_EXTERNAL_LARGEFILE=y
BR2_TOOLCHAIN_EXTERNAL_INET_IPV6=y
BR2_TOOLCHAIN_EXTERNAL_INET_RPC=y
BR2_TOOLCHAIN_EXTERNAL_LOCALE=y
BR2_TOOLCHAIN_EXTERNAL_CXX=y
BR2_TOOLCHAIN_EXTRA_EXTERNAL_LIBS="libc.so ld-uClibc libcrypt libresolv librt libpthread libdl libm libutil"
BR2_TARGET_GENERIC_HOSTNAME="gfskids"
BR2_TARGET_GENERIC_ISSUE="Welcome to Google Fiber"
BR2_ROOTFS_DEVICE_CREATION_DYNAMIC_DEVTMPFS=y
BR2_ROOTFS_DEVICE_TABLE="/dev/null"
BR2_ROOTFS_SKELETON_CUSTOM=y
BR2_ROOTFS_POST_BUILD_SCRIPT="${TOPDIR}/support/scripts/postbuild.sh"
BR2_TARGET_GENERIC_PLATFORM_NAME="gfex250"
BR2_TARGET_GENERIC_PLATFORMS_SUPPORTED="GFEX250"
BR2_PACKAGE_BUSYBOX_CONFIG="package/busybox/skids.config"
BR2_PACKAGE_BUSYBOX_SHOW_OTHERS=y
BR2_PACKAGE_LIBLOCKFILE=y
BR2_PACKAGE_HOSTAPD=y
BR2_PACKAGE_WPA_SUPPLICANT=y
BR2_PACKAGE_DASH=y
BR2_TARGET_ROOTFS_INITRAMFS=y
BR2_TARGET_ROOTFS_GINSTALL=y
BR2_TARGET_ROOTFS_GINSTALL_V4=y
BR2_LINUX_KERNEL=y
BR2_LINUX_KERNEL_CUSTOM_GIT=y
BR2_LINUX_KERNEL_CUSTOM_GIT_REPO_URL="repo://kernel/skids"
BR2_LINUX_KERNEL_CUSTOM_GIT_VERSION="HEAD"
BR2_LINUX_KERNEL_DEFCONFIG="skids"
```
