## configs/gflt110_defconfig
```kconfig
BR2_arm=y
BR2_arm926t=y
BR2_GCC_TARGET_TUNE="marvell-f"
BR2_DL_DIR="${TOPDIR}/../vendor/opensource/tarballs"
BR2_JLEVEL=15
BR2_CCACHE=y
BR2_TOOLCHAIN_EXTERNAL=y
BR2_TOOLCHAIN_EXTERNAL_CUSTOM=y
BR2_TOOLCHAIN_EXTERNAL_PATH="${TOPDIR}/../toolchains/prism"
BR2_TOOLCHAIN_EXTERNAL_CUSTOM_PREFIX="arm-marvell-linux-uclibcgnueabi"
BR2_TOOLCHAIN_EXTERNAL_LARGEFILE=y
BR2_TOOLCHAIN_EXTERNAL_INET_IPV6=y
BR2_TOOLCHAIN_EXTERNAL_INET_RPC=y
BR2_TOOLCHAIN_EXTERNAL_WCHAR=y
BR2_TOOLCHAIN_EXTERNAL_CXX=y
BR2_TARGET_GENERIC_HOSTNAME="gfiberjack"
BR2_TARGET_GENERIC_ISSUE="Welcome to Google Fiber"
BR2_ROOTFS_DEVICE_CREATION_DYNAMIC_DEVTMPFS=y
BR2_ROOTFS_DEVICE_TABLE="/dev/null"
BR2_ROOTFS_SKELETON_CUSTOM=y
BR2_ROOTFS_POST_BUILD_SCRIPT="${TOPDIR}/support/scripts/postbuild.sh"
BR2_TARGET_GENERIC_PLATFORM_NAME="gflt110"
BR2_TARGET_GENERIC_PLATFORMS_SUPPORTED="GFLT110, GFLT120"
# BR2_PACKAGE_BUSYBOX is not set
BR2_PACKAGE_TOOLBOX=y
BR2_PACKAGE_TOYBOX=y
BR2_PACKAGE_GREP=y
BR2_PACKAGE_DEVMEM2=y
BR2_PACKAGE_I2C_TOOLS=y
BR2_PACKAGE_MTD=y
# BR2_PACKAGE_MTD_UBIATTACH is not set
# BR2_PACKAGE_MTD_UBICRC32 is not set
# BR2_PACKAGE_MTD_UBIDETACH is not set
# BR2_PACKAGE_MTD_UBIFORMAT is not set
# BR2_PACKAGE_MTD_UBIMKVOL is not set
# BR2_PACKAGE_MTD_UBINFO is not set
# BR2_PACKAGE_MTD_UBINIZE is not set
# BR2_PACKAGE_MTD_UBIRENAME is not set
# BR2_PACKAGE_MTD_UBIRMVOL is not set
# BR2_PACKAGE_MTD_UBIRSVOL is not set
# BR2_PACKAGE_MTD_UBIUPDATEVOL is not set
# BR2_PACKAGE_MTD_UBISCRUBBER is not set
BR2_PACKAGE_UBOOT_TOOLS=y
BR2_PACKAGE_PYTHON=y
BR2_PACKAGE_PYTHON_SSL=y
BR2_PACKAGE_PYTHON_PYEXPAT=y
BR2_PACKAGE_PY_DNS=y
BR2_PACKAGE_PY_MONOTIME=y
BR2_PACKAGE_PY_YAML=y
BR2_PACKAGE_PYTHON_CRYPTO=y
BR2_PACKAGE_SQLITE=y
BR2_PACKAGE_PROTOBUF_VERSION_VALUE="2.6.1"
BR2_PACKAGE_LIBYAML=y
BR2_PACKAGE_DHCP=y
BR2_PACKAGE_DHCP_CLIENT=y
BR2_PACKAGE_DROPBEAR=y
BR2_PACKAGE_ETHTOOL=y
BR2_PACKAGE_IPROUTE2=y
BR2_PACKAGE_IPUTILS=y
BR2_PACKAGE_NDISC6=y
BR2_PACKAGE_NDISC6_NDISC6=y
BR2_PACKAGE_NDISC6_RDISC6=y
BR2_PACKAGE_NETKITTELNET=y
BR2_PACKAGE_DASH=y
BR2_PACKAGE_ZSH=y
BR2_PACKAGE_ZSH_BINARIES_ONLY=y
BR2_PACKAGE_SYSKLOGD=y
BR2_PACKAGE_UTIL_LINUX=y
BR2_PACKAGE_UTIL_LINUX_AGETTY=y
BR2_PACKAGE_UTIL_LINUX_LOGIN_UTILS=y
BR2_PACKAGE_NANO=y
BR2_PACKAGE_GOOGLE_PLATFORM=y
BR2_PACKAGE_GOOGLE_PLATFORM_BASE=y
BR2_PACKAGE_GOOGLE_PLATFORM_LOGUPLOAD=y
BR2_PACKAGE_GOOGLE_PLATFORM_SYSMGR=y
BR2_PACKAGE_GOOGLE_FIBER_JACK=y
BR2_PACKAGE_GOOGLE_PRISM=y
BR2_PACKAGE_CATAWAMPUS=y
BR2_PACKAGE_MV_APP_PON_TYPE="GPON"
BR2_PACKAGE_MV_APP=y
BR2_TARGET_ROOTFS_INITRAMFS=y
BR2_TARGET_ROOTFS_GINSTALL=y
BR2_TARGET_ROOTFS_GINSTALL_LOADER_DIR="../loader-bin/marvell/gflt110"
BR2_TARGET_UBOOT=y
BR2_TARGET_UBOOT_BOARDNAME="gflt110"
BR2_TARGET_UBOOT_CUSTOM_GIT=y
BR2_TARGET_UBOOT_CUSTOM_GIT_REPO_URL="repo://uboot/prism"
BR2_TARGET_UBOOT_CUSTOM_GIT_VERSION="HEAD"
BR2_TARGET_UBOOT_FORMAT_SPI_BIN=y
BR2_LINUX_KERNEL=y
BR2_LINUX_KERNEL_CUSTOM_GIT=y
BR2_LINUX_KERNEL_CUSTOM_GIT_REPO_URL="repo://kernel/prism"
BR2_LINUX_KERNEL_CUSTOM_GIT_VERSION="HEAD"
BR2_LINUX_KERNEL_DEFCONFIG="gflt110"
BR2_LINUX_KERNEL_ZIMAGE=y
```

## configs/gfmn100_defconfig
```kconfig
BR2_mips=y
BR2_mips_32r2=y
BR2_DL_DIR="${TOPDIR}/../vendor/opensource/tarballs"
BR2_JLEVEL=15
BR2_TOOLCHAIN_EXTERNAL=y
BR2_TOOLCHAIN_EXTERNAL_CUSTOM=y
BR2_TOOLCHAIN_EXTERNAL_PATH="${TOPDIR}/../toolchains/windcharger"
BR2_TOOLCHAIN_EXTERNAL_CUSTOM_PREFIX="mips-qca-linux-uclibc"
BR2_TOOLCHAIN_EXTERNAL_LARGEFILE=y
BR2_TOOLCHAIN_EXTERNAL_INET_IPV6=y
BR2_TOOLCHAIN_EXTERNAL_INET_RPC=y
BR2_TOOLCHAIN_EXTERNAL_WCHAR=y
BR2_TOOLCHAIN_EXTERNAL_CXX=y
BR2_TARGET_GENERIC_HOSTNAME="gfwindcharger"
BR2_TARGET_GENERIC_ISSUE="Welcome to Google Fiber"
BR2_ROOTFS_DEVICE_CREATION_DYNAMIC_DEVTMPFS=y
BR2_ROOTFS_DEVICE_TABLE="/dev/null"
BR2_ROOTFS_SKELETON_CUSTOM=y
BR2_ROOTFS_POST_BUILD_SCRIPT="${TOPDIR}/support/scripts/postbuild.sh"
BR2_TARGET_GENERIC_PLATFORM_NAME="gfmn100"
BR2_TARGET_GENERIC_PLATFORMS_SUPPORTED="GFMN100"
# BR2_PACKAGE_BUSYBOX is not set
BR2_PACKAGE_TOOLBOX=y
BR2_PACKAGE_TOYBOX=y
BR2_PACKAGE_GZIP=y
BR2_PACKAGE_MEMTESTER=y
BR2_PACKAGE_MTD=y
BR2_PACKAGE_PYTHON=y
BR2_PACKAGE_PYTHON_SSL=y
BR2_PACKAGE_PYTHON_PYEXPAT=y
BR2_PACKAGE_PY_DNS=y
BR2_PACKAGE_PY_MONOTIME=y
BR2_PACKAGE_PYTHON_CRYPTO=y
BR2_PACKAGE_LIBNETFILTER_CONNTRACK=y
BR2_PACKAGE_NCURSES=y
BR2_PACKAGE_BRIDGE_UTILS=y
BR2_PACKAGE_DHCP=y
BR2_PACKAGE_DHCP_CLIENT=y
BR2_PACKAGE_DNSMASQ=y
BR2_PACKAGE_DROPBEAR=y
BR2_PACKAGE_HOSTAPD=y
BR2_PACKAGE_IPROUTE2=y
BR2_PACKAGE_IPTABLES=y
BR2_PACKAGE_IPUTILS=y
BR2_PACKAGE_IW=y
BR2_PACKAGE_MINIUPNPD=y
BR2_PACKAGE_NDISC6=y
BR2_PACKAGE_NDISC6_NDISC6=y
BR2_PACKAGE_NDISC6_RDISC6=y
BR2_PACKAGE_WIRELESS_TOOLS=y
BR2_PACKAGE_WIRELESS_TOOLS_LIB=y
BR2_PACKAGE_DASH=y
BR2_PACKAGE_MODULE_INIT_TOOLS=y
BR2_PACKAGE_SYSKLOGD=y
BR2_PACKAGE_UTIL_LINUX=y
BR2_PACKAGE_UTIL_LINUX_AGETTY=y
BR2_PACKAGE_UTIL_LINUX_LOGIN_UTILS=y
BR2_PACKAGE_GOOGLE_PLATFORM=y
BR2_PACKAGE_GOOGLE_PLATFORM_BASE=y
BR2_PACKAGE_GOOGLE_PLATFORM_LOGUPLOAD=y
BR2_PACKAGE_GOOGLE_WINDCHARGER=y
BR2_PACKAGE_CATAWAMPUS=y
BR2_PACKAGE_ART2=y
BR2_PACKAGE_BACKPORTS_CUSTOM=y
BR2_PACKAGE_BACKPORTS_CUSTOM_DEFCONFIG="gfmn100_defconfig"
BR2_TARGET_ROOTFS_TAR=n
BR2_TARGET_ROOTFS_GINSTALL=y
BR2_TARGET_ROOTFS_GINSTALL_V4=y
BR2_TARGET_ROOTFS_GINSTALL_LOADER_DIR="../loader-bin/qualcomm/gfmn100"
BR2_TARGET_UBOOT=y
BR2_TARGET_UBOOT_BOARDNAME="gfmn100"
BR2_TARGET_UBOOT_CUSTOM_GIT=y
BR2_TARGET_UBOOT_CUSTOM_GIT_REPO_URL="repo://uboot/windcharger"
BR2_TARGET_UBOOT_CUSTOM_GIT_VERSION="HEAD"
BR2_LINUX_KERNEL=y
BR2_LINUX_KERNEL_CUSTOM_GIT=y
BR2_LINUX_KERNEL_CUSTOM_GIT_REPO_URL="repo://kernel/windcharger"
BR2_LINUX_KERNEL_CUSTOM_GIT_VERSION="HEAD"
BR2_LINUX_KERNEL_PATCH="${TOPDIR}/../kernel/windcharger/"
BR2_LINUX_KERNEL_DEFCONFIG="gfmn100"
```

## configs/gfrg200_defconfig
```kconfig
BR2_arm=y
BR2_cortex_a9=y
BR2_GCC_TARGET_TUNE=""
BR2_DL_DIR="${TOPDIR}/../vendor/opensource/tarballs"
BR2_JLEVEL=15
BR2_CCACHE=y
BR2_ENABLE_DEBUG=y
BR2_OPTIMIZE_2=y
BR2_TOOLCHAIN_EXTERNAL=y
BR2_TOOLCHAIN_EXTERNAL_CUSTOM=y
BR2_TOOLCHAIN_EXTERNAL_PATH="${TOPDIR}/../toolchains/mindspeed"
BR2_TOOLCHAIN_EXTERNAL_CUSTOM_PREFIX="arm-linux"
BR2_TOOLCHAIN_EXTERNAL_CUSTOM_GLIBC=y
BR2_TOOLCHAIN_EXTERNAL_CXX=y
BR2_PACKAGE_GDB=y
BR2_GDB_VERSION_7_7=y
BR2_TARGET_OPTIMIZATION="-pipe -fstack-protector-all -Wl,-z,relro,-z,now,-z,noexecstack"
BR2_TARGET_LDFLAGS="-Wl,-z,relro,-z,now,-z,noexecstack"
BR2_ROOTFS_DEVICE_CREATION_DYNAMIC_DEVTMPFS=y
BR2_ROOTFS_DEVICE_TABLE="/dev/null"
BR2_ROOTFS_SKELETON_CUSTOM=y
BR2_ROOTFS_POST_BUILD_SCRIPT="${TOPDIR}/support/scripts/postbuild.sh"
BR2_TARGET_GENERIC_PLATFORM_NAME="gfrg200"
BR2_TARGET_GENERIC_PLATFORMS_SUPPORTED="GFRG200 GFRG210"
# BR2_PACKAGE_BUSYBOX is not set
BR2_PACKAGE_GZIP=y
BR2_PACKAGE_PKG_CONFIG=y
BR2_PACKAGE_TAR=y
BR2_PACKAGE_E2FSPROGS=y
BR2_PACKAGE_HDPARM=y
BR2_PACKAGE_HWDATA=y
BR2_PACKAGE_I2C_TOOLS=y
# BR2_PACKAGE_MTD_UBINIZE is not set
BR2_PACKAGE_SMARTMONTOOLS=y
BR2_PACKAGE_USB_MODESWITCH=y
BR2_PACKAGE_USBUTILS=y
BR2_PACKAGE_PYTHON=y
BR2_PACKAGE_PYTHON_BZIP2=y
BR2_PACKAGE_PYTHON_PYEXPAT=y
BR2_PACKAGE_PYTHON_READLINE=y
BR2_PACKAGE_PYTHON_SSL=y
BR2_PACKAGE_PYTHON_IPV6=y
BR2_PACKAGE_PY_GOOGLE_API=y
BR2_PACKAGE_PY_DNS=y
BR2_PACKAGE_PY_MONOTIME=y
BR2_PACKAGE_PYTHON_CRYPTO=y
BR2_PACKAGE_OPENSSL_BIN=y
BR2_PACKAGE_INADYN=y
BR2_PACKAGE_LIBNETFILTER_CONNTRACK=y
BR2_PACKAGE_LIBCLI=y
# BR2_PACKAGE_AVAHI_AUTOIPD is not set
BR2_PACKAGE_BRIDGE_UTILS=y
BR2_PACKAGE_DHCP=y
BR2_PACKAGE_DHCP_CLIENT=y
BR2_PACKAGE_DNSMASQ=y
# BR2_PACKAGE_DNSMASQ_TFTP is not set
BR2_PACKAGE_EBTABLES=y
BR2_PACKAGE_HOSTAPD=y
BR2_PACKAGE_IGMPPROXY=y
BR2_PACKAGE_IPROUTE2=y
BR2_PACKAGE_IPTABLES=y
BR2_PACKAGE_IPUTILS=y
BR2_PACKAGE_IW=y
BR2_PACKAGE_MINIUPNPD=y
BR2_PACKAGE_NDISC6=y
BR2_PACKAGE_NDISC6_NDISC6=y
BR2_PACKAGE_NDISC6_RDISC6=y
# BR2_PACKAGE_SAMBA_EVENTLOGADM is not set
# BR2_PACKAGE_SAMBA_NET is not set
# BR2_PACKAGE_SAMBA_NTLM_AUTH is not set
# BR2_PACKAGE_SAMBA_PDBEDIT is not set
# BR2_PACKAGE_SAMBA_PROFILES is not set
# BR2_PACKAGE_SAMBA_RPCCLIENT is not set
# BR2_PACKAGE_SAMBA_SMBCACLS is not set
# BR2_PACKAGE_SAMBA_SMBCLIENT is not set
# BR2_PACKAGE_SAMBA_SMBCONTROL is not set
# BR2_PACKAGE_SAMBA_SMBCQUOTAS is not set
# BR2_PACKAGE_SAMBA_SMBGET is not set
# BR2_PACKAGE_SAMBA_SMBLDBTOOLS is not set
# BR2_PACKAGE_SAMBA_SMBPASSWD is not set
# BR2_PACKAGE_SAMBA_SMBSHARESEC is not set
# BR2_PACKAGE_SAMBA_SMBSPOOL is not set
# BR2_PACKAGE_SAMBA_SMBSTATUS is not set
# BR2_PACKAGE_SAMBA_SMBTREE is not set
# BR2_PACKAGE_SAMBA_SWAT is not set
# BR2_PACKAGE_SAMBA_TDB is not set
# BR2_PACKAGE_SAMBA_TESTPARM is not set
# BR2_PACKAGE_SAMBA_WINBINDD is not set
BR2_PACKAGE_VCONFIG=y
BR2_PACKAGE_WIRELESS_TOOLS=y
BR2_PACKAGE_WIRELESS_TOOLS_LIB=y
BR2_PACKAGE_WPA_SUPPLICANT=y
BR2_PACKAGE_WPA_SUPPLICANT_CLI=y
BR2_PACKAGE_WPA_SUPPLICANT_PASSPHRASE=y
BR2_PACKAGE_MODULE_INIT_TOOLS=y
BR2_PACKAGE_UTIL_LINUX_SWITCH_ROOT=y
BR2_PACKAGE_GOOGLE_SKELMIR=y
BR2_PACKAGE_GOOGLE_PLATFORM=y
BR2_PACKAGE_GOOGLE_PLATFORM_BASE=y
BR2_PACKAGE_GOOGLE_PLATFORM_HNVRAM=y
BR2_PACKAGE_GOOGLE_PLATFORM_WAVEGUIDE=y
BR2_PACKAGE_GOOGLE_PLATFORM_LOGUPLOAD=y
BR2_PACKAGE_GOOGLE_PLATFORM_SYSMGR=y
BR2_PACKAGE_GOOGLE_TEST=y
BR2_PACKAGE_GOOGLE_NETWORK_BOX=y
BR2_PACKAGE_GOOGLE_STORAGE_BOX=y
BR2_PACKAGE_CATAWAMPUS=y
BR2_PACKAGE_BCM_DRIVERS=y
BR2_PACKAGE_BCM_DRIVER_MOCA2=y
BR2_PACKAGE_MINDSPEED_DRIVERS=y
BR2_PACKAGE_MINDSPEED_DRIVER_PFE=y
BR2_PACKAGE_QUALCOMM_SWITCH=y
BR2_PACKAGE_BACKPORTS_CUSTOM=y
BR2_PACKAGE_BACKPORTS_CUSTOM_DEFCONFIG="gfrg200_defconfig"
BR2_PACKAGE_FIRMWARE=y
BR2_PACKAGE_FIRMWARE_FILENAMES="ath10k/QCA988X/hw2.0/*.bin htc_9271.fw rtlwifi/rtl8192cufw.bin ar9*.fw mrvl/usb8[78]97* ./mwl8k/fmimage_8764_ap-1.fw"
BR2_TARGET_ROOTFS_SQUASHFS=y
# BR2_TARGET_ROOTFS_TAR is not set
BR2_PACKAGE_SIMPLERAMFS=y
BR2_TARGET_ROOTFS_GINSTALL=y
BR2_TARGET_ROOTFS_GINSTALL_V4=y
BR2_TARGET_ROOTFS_GINSTALL_LOADER_DIR="../loader-bin/mindspeed/optimus"
BR2_LINUX_KERNEL=y
BR2_LINUX_KERNEL_CUSTOM_GIT=y
BR2_LINUX_KERNEL_CUSTOM_GIT_REPO_URL="repo://kernel/mindspeed"
BR2_LINUX_KERNEL_CUSTOM_GIT_VERSION="HEAD"
BR2_LINUX_KERNEL_DEFCONFIG="gfrg200"
BR2_LINUX_KERNEL_ZIMAGE=y
```

## configs/gfrg200_toolchain_defconfig
```kconfig
BR2_arm=y
BR2_cortex_a9=y
BR2_DL_DIR="${TOPDIR}/../vendor/opensource/tarballs"
BR2_JLEVEL=12
BR2_CCACHE=y
BR2_ENABLE_DEBUG=y
BR2_OPTIMIZE_2=y
BR2_TOOLCHAIN_CTNG=y
BR2_TOOLCHAIN_CTNG_glibc=y
BR2_TOOLCHAIN_CTNG_CXX=y
BR2_ENABLE_LOCALE_PURGE=y
BR2_ENABLE_LOCALE_WHITELIST="C"
# BR2_SOFT_FLOAT is not set
BR2_ROOTFS_DEVICE_CREATION_DYNAMIC_DEVTMPFS=y
BR2_ROOTFS_DEVICE_TABLE="/dev/null"
BR2_ROOTFS_SKELETON_CUSTOM=y
# BR2_PACKAGE_BUSYBOX is not set
# BR2_TARGET_ROOTFS_TAR is not set
```

## configs/gfsc100_defconfig
```kconfig
BR2_arm=y
BR2_cortex_a9=y
BR2_GCC_TARGET_TUNE=""
BR2_DL_DIR="${TOPDIR}/../vendor/opensource/tarballs"
BR2_JLEVEL=15
BR2_CCACHE=y
BR2_ENABLE_DEBUG=y
BR2_OPTIMIZE_2=y
BR2_TOOLCHAIN_EXTERNAL=y
BR2_TOOLCHAIN_EXTERNAL_CUSTOM=y
BR2_TOOLCHAIN_EXTERNAL_PATH="${TOPDIR}/../toolchains/mindspeed"
BR2_TOOLCHAIN_EXTERNAL_CUSTOM_PREFIX="arm-linux"
BR2_TOOLCHAIN_EXTERNAL_CUSTOM_GLIBC=y
BR2_TOOLCHAIN_EXTERNAL_CXX=y
BR2_PACKAGE_GDB=y
BR2_GDB_VERSION_7_7=y
BR2_ENABLE_LOCALE_PURGE=y
BR2_TARGET_OPTIMIZATION="-pipe -fstack-protector-all -Wl,-z,relro,-z,now,-z,noexecstack"
BR2_TARGET_LDFLAGS="-Wl,-z,relro,-z,now,-z,noexecstack"
BR2_ROOTFS_DEVICE_CREATION_DYNAMIC_DEVTMPFS=y
BR2_ROOTFS_DEVICE_TABLE="/dev/null"
BR2_ROOTFS_SKELETON_CUSTOM=y
BR2_ROOTFS_POST_BUILD_SCRIPT="${TOPDIR}/support/scripts/postbuild.sh"
BR2_TARGET_GENERIC_PLATFORM_NAME="gfsc100"
BR2_TARGET_GENERIC_PLATFORMS_SUPPORTED="GFSC100"
# BR2_PACKAGE_BUSYBOX is not set
BR2_PACKAGE_GZIP=y
BR2_PACKAGE_PKG_CONFIG=y
BR2_PACKAGE_TAR=y
BR2_PACKAGE_POPT=y
BR2_PACKAGE_DBUS=y
BR2_PACKAGE_DBUS_CPP=y
BR2_PACKAGE_E2FSPROGS=y
BR2_PACKAGE_HDPARM=y
BR2_PACKAGE_HWDATA=y
BR2_PACKAGE_I2C_TOOLS=y
# BR2_PACKAGE_MTD_UBINIZE is not set
BR2_PACKAGE_SMARTMONTOOLS=y
BR2_PACKAGE_USB_MODESWITCH=y
BR2_PACKAGE_USBUTILS=y
BR2_PACKAGE_PYTHON=y
BR2_PACKAGE_PYTHON_BZIP2=y
BR2_PACKAGE_PYTHON_PYEXPAT=y
BR2_PACKAGE_PYTHON_READLINE=y
BR2_PACKAGE_PYTHON_IPV6=y
BR2_PACKAGE_PY_DNS=y
BR2_PACKAGE_PY_MONOTIME=y
BR2_PACKAGE_PYTHON_CRYPTO=y
BR2_PACKAGE_PYTHON_SETUPTOOLS=y
BR2_PACKAGE_OPENSSL_BIN=y
BR2_PACKAGE_GPTFDISK=y
BR2_PACKAGE_GPTFDISK_GDISK=y
BR2_PACKAGE_GPTFDISK_SGDISK=y
BR2_PACKAGE_LIBCURL=y
BR2_PACKAGE_LIBNETFILTER_CONNTRACK=y
BR2_PACKAGE_LIBCLI=y
BR2_PACKAGE_BRIDGE_UTILS=y
BR2_PACKAGE_DHCP=y
BR2_PACKAGE_DHCP_CLIENT=y
BR2_PACKAGE_EBTABLES=y
BR2_PACKAGE_IPROUTE2=y
BR2_PACKAGE_IPTABLES=y
BR2_PACKAGE_IPUTILS=y
BR2_PACKAGE_NDISC6=y
BR2_PACKAGE_NDISC6_NDISC6=y
BR2_PACKAGE_NDISC6_RDISC6=y
BR2_PACKAGE_VCONFIG=y
BR2_PACKAGE_MODULE_INIT_TOOLS=y
BR2_PACKAGE_UTIL_LINUX_SWITCH_ROOT=y
BR2_PACKAGE_GOOGLE_PLATFORM=y
BR2_PACKAGE_GOOGLE_PLATFORM_BASE=y
BR2_PACKAGE_GOOGLE_PLATFORM_DVBUTILS=y
BR2_PACKAGE_GOOGLE_PLATFORM_HNVRAM=y
BR2_PACKAGE_GOOGLE_TEST=y
BR2_PACKAGE_GOOGLE_SPACECAST=y
BR2_PACKAGE_GOOGLE_BUFFET=y
BR2_PACKAGE_MINDSPEED_DRIVERS=y
BR2_PACKAGE_MINDSPEED_DRIVER_PFE=y
BR2_PACKAGE_QUALCOMM_SWITCH=y
BR2_PACKAGE_FIRMWARE=y
BR2_PACKAGE_FIRMWARE_FILENAMES="dvb-usb-sc100.fw dvbsky-firmware/dvb-fe-rs6000.fw"
BR2_PACKAGE_DVBSNOOP=y
BR2_TARGET_ROOTFS_SQUASHFS=y
BR2_PACKAGE_SIMPLERAMFS=y
BR2_TARGET_ROOTFS_GINSTALL=y
BR2_TARGET_ROOTFS_GINSTALL_V4=y
BR2_TARGET_ROOTFS_GINSTALL_LOADER_DIR="../loader-bin/mindspeed/spacecast"
BR2_LINUX_KERNEL=y
BR2_LINUX_KERNEL_CUSTOM_GIT=y
BR2_LINUX_KERNEL_CUSTOM_GIT_REPO_URL="repo://kernel/mindspeed"
BR2_LINUX_KERNEL_CUSTOM_GIT_VERSION="HEAD"
BR2_LINUX_KERNEL_DEFCONFIG="gfsc100"
BR2_LINUX_KERNEL_ZIMAGE=y
```
